## CMakeLists.txt
```
cmake_minimum_required(VERSION 3.20.0)
find_package(Zephyr REQUIRED HINTS $ENV{ZEPHYR_BASE})
project(hello_test)
target_sources(app PRIVATE src/main.c)
```

## prj.conf
```kconfig
CONFIG_PRINTK=y
CONFIG_CONSOLE=y
CONFIG_UART_CONSOLE=y
CONFIG_SERIAL=y
```

## boards/esp32s3_devkitc_procpu.overlay
```dts
/* CHD-ESP32-S3-BOX: Use USB-Serial/JTAG as console instead of UART0 */

/ {
	chosen {
		zephyr,console = &usb_serial;
		zephyr,shell-uart = &usb_serial;
	};
};

&usb_serial {
	status = "okay";
};
```

## src/main.c
```c
#include <zephyr/kernel.h>

int main(void)
{
    int count = 0;
    printk("\n\n*** Hello from CHD-ESP32-S3-BOX! ***\n");
    printk("Board: %s\n", CONFIG_BOARD_TARGET);
    while (1) {
        printk("tick %d\n", count++);
        k_msleep(2000);
    }
    return 0;
}
```
