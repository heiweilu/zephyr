## CMakeLists.txt
```
cmake_minimum_required(VERSION 3.20.0)
find_package(Zephyr REQUIRED HINTS $ENV{ZEPHYR_BASE})
project(cloud_ai)

target_sources(app PRIVATE src/main.c)
```

## prj.conf
```kconfig
# ── Console ──
CONFIG_PRINTK=y
CONFIG_CONSOLE=y
CONFIG_SERIAL=y

CONFIG_LOG=y
CONFIG_LOG_DEFAULT_LEVEL=3
CONFIG_LOG_BUFFER_SIZE=8192

# ── Networking ──
CONFIG_NETWORKING=y
CONFIG_NET_MGMT=y
CONFIG_NET_MGMT_EVENT_INFO=y
CONFIG_NET_IPV4=y
CONFIG_NET_IPV6=n
CONFIG_NET_TCP=y
CONFIG_NET_DHCPV4=y
CONFIG_NET_SOCKETS=y
CONFIG_POSIX_API=y

# ── WiFi ──
CONFIG_WIFI=y
CONFIG_WIFI_NM=y
CONFIG_NET_L2_WIFI_MGMT=y
CONFIG_ESP32_WIFI_STA_AUTO_DHCPV4=y

# ── DNS ──
CONFIG_DNS_RESOLVER=y
CONFIG_DNS_RESOLVER_AI_MAX_ENTRIES=2

# ── HTTP client ──
CONFIG_HTTP_CLIENT=y

# ── TLS / mbedTLS ──
CONFIG_MBEDTLS=y
CONFIG_MBEDTLS_BUILTIN=y
CONFIG_MBEDTLS_ENABLE_HEAP=y
CONFIG_MBEDTLS_HEAP_SIZE=65536
CONFIG_MBEDTLS_SSL_MAX_CONTENT_LEN=16384
CONFIG_MBEDTLS_CIPHER_GCM_ENABLED=y
CONFIG_MBEDTLS_KEY_EXCHANGE_ECDHE_RSA_ENABLED=y
CONFIG_MBEDTLS_KEY_EXCHANGE_RSA_ENABLED=y
CONFIG_MBEDTLS_ECP_DP_SECP256R1_ENABLED=y
CONFIG_MBEDTLS_ECP_DP_SECP384R1_ENABLED=y
CONFIG_MBEDTLS_ECDH_C=y
CONFIG_MBEDTLS_ECP_C=y
CONFIG_NET_SOCKETS_SOCKOPT_TLS=y
CONFIG_NET_SOCKETS_TLS_MAX_CONTEXTS=2
# SNI + GCM are required by Alibaba Cloud CDN
CONFIG_MBEDTLS_SERVER_NAME_INDICATION=y

# ── Stack & buffers ──
CONFIG_MAIN_STACK_SIZE=8192
CONFIG_SYSTEM_WORKQUEUE_STACK_SIZE=4096
CONFIG_NET_TX_STACK_SIZE=2048
CONFIG_NET_RX_STACK_SIZE=2048
CONFIG_NET_PKT_RX_COUNT=16
CONFIG_NET_PKT_TX_COUNT=16
CONFIG_NET_BUF_RX_COUNT=64
CONFIG_NET_BUF_TX_COUNT=64
CONFIG_NET_MAX_CONTEXTS=8
CONFIG_NET_MGMT_EVENT_QUEUE_TIMEOUT=5000
CONFIG_NET_MGMT_EVENT_QUEUE_SIZE=16

# ── Heap (for JSON / response buffer) ──
CONFIG_HEAP_MEM_POOL_SIZE=32768
```

## boards/esp32s3_devkitc_procpu.overlay
```dts
/* CHD-ESP32-S3-BOX: USB-Serial console */

/ {
	chosen {
		zephyr,console = &usb_serial;
		zephyr,shell-uart = &usb_serial;
	};
};

&usb_serial {
	status = "okay";
};
```

## src/main.c
```c
/*
 * Cloud AI Chat — Phase 10: 云端 AI 对话
 *
 * WiFi → DNS → TLS → HTTP POST to Alibaba Bailian (qwen3.5-omni-flash)
 * Serial text interaction.
 */

#include <zephyr/kernel.h>
#include <zephyr/logging/log.h>
#include <string.h>
#include <errno.h>

#include <zephyr/net/net_event.h>
#include <zephyr/net/net_if.h>
#include <zephyr/net/net_ip.h>
#include <zephyr/net/net_mgmt.h>
#include <zephyr/net/wifi.h>
#include <zephyr/net/wifi_mgmt.h>
#include <zephyr/net/socket.h>
#include <zephyr/net/tls_credentials.h>
#include <zephyr/net/http/client.h>
#include <zephyr/net/dns_resolve.h>

#include "secrets.h"
#include "ca_certificate.h"

LOG_MODULE_REGISTER(cloud_ai, LOG_LEVEL_INF);

/* ── API config ── */
#define AI_HOST        "dashscope.aliyuncs.com"
#define AI_PORT        443
#define AI_URL         "/compatible-mode/v1/chat/completions"
#define AI_MODEL       "qwen3.5-omni-flash"

/* ── Buffers ── */
#define HTTP_RECV_BUF_SIZE  4096
#define HTTP_TIMEOUT_MS     30000
#define JSON_REQ_BUF_SIZE   1024
#define JSON_RSP_BUF_SIZE   4096

static uint8_t http_recv_buf[HTTP_RECV_BUF_SIZE];
static char    json_req_buf[JSON_REQ_BUF_SIZE];
static char    json_rsp_buf[JSON_RSP_BUF_SIZE];
static size_t  json_rsp_len;

/* ── WiFi state ── */
static struct net_if *sta_iface;
static struct net_mgmt_event_callback wifi_cb;
static struct net_mgmt_event_callback ipv4_cb;

static K_SEM_DEFINE(wifi_connected_sem, 0, 1);
static K_SEM_DEFINE(ipv4_ready_sem, 0, 1);
static K_SEM_DEFINE(scan_done_sem, 0, 1);

/* ================================================================
 *  WiFi helpers (simplified from wifi_test)
 * ================================================================ */

static void handle_wifi_event(struct net_mgmt_event_callback *cb,
			      uint64_t mgmt_event,
			      struct net_if *iface)
{
	ARG_UNUSED(iface);

	if (mgmt_event == NET_EVENT_WIFI_SCAN_DONE) {
		LOG_INF("WiFi scan done");
		k_sem_give(&scan_done_sem);
	} else if (mgmt_event == NET_EVENT_WIFI_CONNECT_RESULT) {
		if (cb->info && cb->info_length == sizeof(struct wifi_status)) {
			const struct wifi_status *status = cb->info;
			if (status->status == WIFI_STATUS_CONN_SUCCESS) {
				LOG_INF("WiFi connected to %s", WIFI_SSID);
				k_sem_give(&wifi_connected_sem);
			} else {
				LOG_ERR("WiFi connect failed: %d", status->status);
			}
		}
	} else if (mgmt_event == NET_EVENT_WIFI_DISCONNECT_RESULT) {
		LOG_WRN("WiFi disconnected");
	}
}

static void handle_ipv4_event(struct net_mgmt_event_callback *cb,
			      uint64_t mgmt_event,
			      struct net_if *iface)
{
	ARG_UNUSED(cb);
	ARG_UNUSED(iface);

	if (mgmt_event == NET_EVENT_IPV4_ADDR_ADD) {
		LOG_INF("IPv4 address acquired");
		k_sem_give(&ipv4_ready_sem);
	}
}

static int wifi_connect(void)
{
	struct wifi_connect_req_params params = {0};

	sta_iface = net_if_get_default();
	if (!sta_iface) {
		LOG_ERR("No default network interface");
		return -ENODEV;
	}

	net_mgmt_init_event_callback(&wifi_cb, handle_wifi_event,
				     NET_EVENT_WIFI_SCAN_DONE |
				     NET_EVENT_WIFI_CONNECT_RESULT |
				     NET_EVENT_WIFI_DISCONNECT_RESULT);
	net_mgmt_add_event_callback(&wifi_cb);

	net_mgmt_init_event_callback(&ipv4_cb, handle_ipv4_event,
				     NET_EVENT_IPV4_ADDR_ADD);
	net_mgmt_add_event_callback(&ipv4_cb);

	params.ssid = (const uint8_t *)WIFI_SSID;
	params.ssid_length = strlen(WIFI_SSID);
	params.psk = (const uint8_t *)WIFI_PSK;
	params.psk_length = strlen(WIFI_PSK);
	params.band = WIFI_FREQ_BAND_UNKNOWN;
	params.channel = WIFI_CHANNEL_ANY;
	params.security = WIFI_SECURITY_TYPE_PSK;
	params.mfp = WIFI_MFP_OPTIONAL;
	params.timeout = SYS_FOREVER_MS;

	/* Scan first to ensure WiFi subsystem is ready */
	int ret;
	LOG_INF("Scanning WiFi ...");
	for (int attempt = 1; attempt <= 10; attempt++) {
		ret = net_mgmt(NET_REQUEST_WIFI_SCAN, sta_iface, NULL, 0);
		if (ret == 0) {
			break;
		}
		k_msleep(500);
	}
	if (ret) {
		LOG_ERR("WiFi scan request failed: %d", ret);
		return ret;
	}
	if (k_sem_take(&scan_done_sem, K_SECONDS(15))) {
		LOG_ERR("WiFi scan timeout");
		return -ETIMEDOUT;
	}

	LOG_INF("Connecting to WiFi: %s ...", WIFI_SSID);
	ret = net_mgmt(NET_REQUEST_WIFI_CONNECT, sta_iface, &params,
		       sizeof(struct wifi_connect_req_params));
	if (ret) {
		LOG_ERR("WiFi connect request failed: %d", ret);
		return ret;
	}

	if (k_sem_take(&wifi_connected_sem, K_SECONDS(30))) {
		LOG_ERR("WiFi connect timeout");
		return -ETIMEDOUT;
	}

	LOG_INF("Waiting for IPv4 ...");
	if (k_sem_take(&ipv4_ready_sem, K_SECONDS(30))) {
		LOG_ERR("DHCPv4 timeout");
		return -ETIMEDOUT;
	}

	return 0;
}

/* ================================================================
 *  TLS socket helpers
 * ================================================================ */

static int tls_setup(void)
{
	int ret;

	ret = tls_credential_add(CA_CERTIFICATE_TAG,
				 TLS_CREDENTIAL_CA_CERTIFICATE,
				 ca_certificate,
				 sizeof(ca_certificate));
	if (ret < 0) {
		LOG_ERR("Failed to register CA certificate: %d", ret);
		return ret;
	}

	LOG_INF("CA certificate registered (tag %d, %zu bytes)",
		CA_CERTIFICATE_TAG, sizeof(ca_certificate));
	return 0;
}

static int tls_connect(int *sock)
{
	struct zsock_addrinfo hints = {0};
	struct zsock_addrinfo *res = NULL;
	int ret;

	hints.ai_family = AF_INET;
	hints.ai_socktype = SOCK_STREAM;

	LOG_INF("Resolving %s ...", AI_HOST);

	ret = zsock_getaddrinfo(AI_HOST, "443", &hints, &res);
	if (ret || !res) {
		LOG_ERR("DNS resolve failed: %d", ret);
		return -EHOSTUNREACH;
	}

	char addr_str[INET_ADDRSTRLEN];
	struct sockaddr_in *addr4 = (struct sockaddr_in *)res->ai_addr;
	zsock_inet_ntop(AF_INET, &addr4->sin_addr, addr_str, sizeof(addr_str));
	LOG_INF("Resolved to %s", addr_str);

	/* Create TLS socket */
	*sock = zsock_socket(AF_INET, SOCK_STREAM, IPPROTO_TLS_1_2);
	if (*sock < 0) {
		LOG_ERR("Failed to create TLS socket: %d", errno);
		zsock_freeaddrinfo(res);
		return -errno;
	}

	/* Set TLS options */
	sec_tag_t sec_tag_list[] = { CA_CERTIFICATE_TAG };

	ret = zsock_setsockopt(*sock, SOL_TLS, TLS_SEC_TAG_LIST,
			       sec_tag_list, sizeof(sec_tag_list));
	if (ret < 0) {
		LOG_ERR("Failed to set TLS_SEC_TAG_LIST: %d", errno);
		zsock_close(*sock);
		zsock_freeaddrinfo(res);
		return -errno;
	}

	ret = zsock_setsockopt(*sock, SOL_TLS, TLS_HOSTNAME,
			       TLS_PEER_HOSTNAME, sizeof(TLS_PEER_HOSTNAME));
	if (ret < 0) {
		LOG_ERR("Failed to set TLS_HOSTNAME: %d", errno);
		zsock_close(*sock);
		zsock_freeaddrinfo(res);
		return -errno;
	}

	LOG_INF("TLS connecting to %s:%d ...", AI_HOST, AI_PORT);

	ret = zsock_connect(*sock, res->ai_addr, res->ai_addrlen);
	zsock_freeaddrinfo(res);

	if (ret < 0) {
		LOG_ERR("TLS connect failed: %d", errno);
		zsock_close(*sock);
		return -errno;
	}

	LOG_INF("TLS connected!");
	return 0;
}

/* ================================================================
 *  HTTP + JSON helpers
 * ================================================================ */

static int build_json_request(const char *user_msg)
{
	int len = snprintk(json_req_buf, sizeof(json_req_buf),
		"{\"model\":\"%s\","
		"\"messages\":["
		"{\"role\":\"system\",\"content\":\"You are a helpful assistant. Reply in Chinese. Keep answers concise.\"},"
		"{\"role\":\"user\",\"content\":\"%s\"}"
		"],"
		"\"enable_thinking\":false"
		"}",
		AI_MODEL, user_msg);

	if (len < 0 || len >= (int)sizeof(json_req_buf)) {
		LOG_ERR("JSON request too large");
		return -ENOMEM;
	}

	return len;
}

/* Simple string search to extract "content":"..." from JSON response */
static const char *extract_content(const char *json, size_t len)
{
	/* Find the last "content":" in the response (the assistant's reply) */
	const char *needle = "\"content\":\"";
	const char *found = NULL;
	const char *p = json;

	while (p < json + len) {
		const char *hit = strstr(p, needle);
		if (!hit) {
			break;
		}
		found = hit;
		p = hit + 1;
	}

	if (!found) {
		/* Try alternative: "content": " (with space) */
		needle = "\"content\": \"";
		p = json;
		while (p < json + len) {
			const char *hit = strstr(p, needle);
			if (!hit) {
				break;
			}
			found = hit;
			p = hit + 1;
		}
	}

	if (!found) {
		return NULL;
	}

	return found + strlen(needle);
}

static void print_ai_response(const char *json, size_t len)
{
	const char *content = extract_content(json, len);

	if (!content) {
		LOG_ERR("Failed to extract content from response");
		LOG_INF("Raw response (%zu bytes): %.*s", len,
			(int)(len > 500 ? 500 : len), json);
		return;
	}

	/* Print until closing quote (handle escaped quotes) */
	printk("\n=== AI Response ===\n");
	for (const char *p = content; *p && p < json + len; p++) {
		if (*p == '\\' && *(p + 1)) {
			p++;
			switch (*p) {
			case 'n':
				printk("\n");
				break;
			case 't':
				printk("\t");
				break;
			case '"':
				printk("\"");
				break;
			case '\\':
				printk("\\");
				break;
			default:
				printk("\\%c", *p);
				break;
			}
		} else if (*p == '"') {
			break;
		} else {
			printk("%c", *p);
		}
	}
	printk("\n===================\n");
}

static int http_response_cb(struct http_response *rsp,
			    enum http_final_call final_data,
			    void *user_data)
{
	if (rsp->data_len > 0) {
		size_t copy_len = rsp->data_len;

		if (json_rsp_len + copy_len >= JSON_RSP_BUF_SIZE) {
			copy_len = JSON_RSP_BUF_SIZE - json_rsp_len - 1;
		}

		if (copy_len > 0) {
			memcpy(json_rsp_buf + json_rsp_len, rsp->recv_buf, copy_len);
			json_rsp_len += copy_len;
			json_rsp_buf[json_rsp_len] = '\0';
		}
	}

	if (final_data == HTTP_DATA_FINAL) {
		LOG_INF("HTTP response complete (%zu bytes)", json_rsp_len);
	}

	return 0;
}

static int send_ai_request(int sock, const char *question)
{
	struct http_request req = {0};
	int json_len;
	char content_len_str[16];
	int ret;

	json_len = build_json_request(question);
	if (json_len < 0) {
		return json_len;
	}

	snprintk(content_len_str, sizeof(content_len_str), "%d", json_len);

	/* Build authorization header */
	static char auth_header[128];
	snprintk(auth_header, sizeof(auth_header),
		 "Authorization: Bearer %s\r\n", AI_API_KEY);

	const char *headers[] = {
		"Content-Type: application/json\r\n",
		auth_header,
		NULL
	};

	/* Reset response buffer */
	json_rsp_len = 0;
	memset(json_rsp_buf, 0, sizeof(json_rsp_buf));

	req.method = HTTP_POST;
	req.url = AI_URL;
	req.host = AI_HOST;
	req.protocol = "HTTP/1.1";
	req.payload = json_req_buf;
	req.payload_len = json_len;
	req.header_fields = headers;
	req.response = http_response_cb;
	req.recv_buf = http_recv_buf;
	req.recv_buf_len = sizeof(http_recv_buf);

	LOG_INF("Sending question: \"%s\"", question);
	LOG_INF("Request payload (%d bytes): %s", json_len, json_req_buf);

	ret = http_client_req(sock, &req, HTTP_TIMEOUT_MS, "AI chat");
	if (ret < 0) {
		LOG_ERR("HTTP request failed: %d", ret);
		return ret;
	}

	LOG_INF("HTTP request sent, total bytes: %d", ret);

	/* Parse and print the response */
	if (json_rsp_len > 0) {
		print_ai_response(json_rsp_buf, json_rsp_len);
	} else {
		LOG_ERR("Empty response from server");
	}

	return 0;
}

/* ================================================================
 *  Main
 * ================================================================ */

int main(void)
{
	int sock = -1;
	int ret;

	LOG_INF("=== Cloud AI Chat (qwen3.5-omni-flash) ===");

	/* Step 1: Connect WiFi */
	ret = wifi_connect();
	if (ret) {
		LOG_ERR("WiFi connection failed");
		return ret;
	}

	/* Step 2: Register TLS CA certificate */
	ret = tls_setup();
	if (ret) {
		return ret;
	}

	/* Step 3: TLS connect to API server */
	ret = tls_connect(&sock);
	if (ret) {
		return ret;
	}

	/* Step 4: Send a test question */
	ret = send_ai_request(sock, "你好，请用一句话介绍你自己。");
	if (ret) {
		LOG_ERR("AI request failed: %d", ret);
	}

	/* Close socket */
	if (sock >= 0) {
		zsock_close(sock);
		LOG_INF("Socket closed");
	}

	LOG_INF("Cloud AI test complete. Entering idle.");

	while (1) {
		k_sleep(K_SECONDS(60));
	}

	return 0;
}
```

## src/ca_certificate.h
```c
/*
 * ca_certificate.h — GlobalSign Root CA - R3 (cross-signed)
 * Used for TLS connection to dashscope.aliyuncs.com
 */
#ifndef CA_CERTIFICATE_H
#define CA_CERTIFICATE_H

#define CA_CERTIFICATE_TAG 1
#define TLS_PEER_HOSTNAME "dashscope.aliyuncs.com"

/* GlobalSign Root CA - R3 (self-signed)
 * Subject: OU=GlobalSign Root CA - R3, O=GlobalSign, CN=GlobalSign
 * Issuer:  OU=GlobalSign Root CA - R3, O=GlobalSign, CN=GlobalSign
 * Valid:   2009-03-18 to 2029-03-18
 * DER size: 867 bytes
 */
static const unsigned char ca_certificate[] = {
	0x30, 0x82, 0x03, 0x5f, 0x30, 0x82, 0x02, 0x47, 0xa0, 0x03, 0x02, 0x01,
	0x02, 0x02, 0x0b, 0x04, 0x00, 0x00, 0x00, 0x00, 0x01, 0x21, 0x58, 0x53,
	0x08, 0xa2, 0x30, 0x0d, 0x06, 0x09, 0x2a, 0x86, 0x48, 0x86, 0xf7, 0x0d,
	0x01, 0x01, 0x0b, 0x05, 0x00, 0x30, 0x4c, 0x31, 0x20, 0x30, 0x1e, 0x06,
	0x03, 0x55, 0x04, 0x0b, 0x13, 0x17, 0x47, 0x6c, 0x6f, 0x62, 0x61, 0x6c,
	0x53, 0x69, 0x67, 0x6e, 0x20, 0x52, 0x6f, 0x6f, 0x74, 0x20, 0x43, 0x41,
	0x20, 0x2d, 0x20, 0x52, 0x33, 0x31, 0x13, 0x30, 0x11, 0x06, 0x03, 0x55,
	0x04, 0x0a, 0x13, 0x0a, 0x47, 0x6c, 0x6f, 0x62, 0x61, 0x6c, 0x53, 0x69,
	0x67, 0x6e, 0x31, 0x13, 0x30, 0x11, 0x06, 0x03, 0x55, 0x04, 0x03, 0x13,
	0x0a, 0x47, 0x6c, 0x6f, 0x62, 0x61, 0x6c, 0x53, 0x69, 0x67, 0x6e, 0x30,
	0x1e, 0x17, 0x0d, 0x30, 0x39, 0x30, 0x33, 0x31, 0x38, 0x31, 0x30, 0x30,
	0x30, 0x30, 0x30, 0x5a, 0x17, 0x0d, 0x32, 0x39, 0x30, 0x33, 0x31, 0x38,
	0x31, 0x30, 0x30, 0x30, 0x30, 0x30, 0x5a, 0x30, 0x4c, 0x31, 0x20, 0x30,
	0x1e, 0x06, 0x03, 0x55, 0x04, 0x0b, 0x13, 0x17, 0x47, 0x6c, 0x6f, 0x62,
	0x61, 0x6c, 0x53, 0x69, 0x67, 0x6e, 0x20, 0x52, 0x6f, 0x6f, 0x74, 0x20,
	0x43, 0x41, 0x20, 0x2d, 0x20, 0x52, 0x33, 0x31, 0x13, 0x30, 0x11, 0x06,
	0x03, 0x55, 0x04, 0x0a, 0x13, 0x0a, 0x47, 0x6c, 0x6f, 0x62, 0x61, 0x6c,
	0x53, 0x69, 0x67, 0x6e, 0x31, 0x13, 0x30, 0x11, 0x06, 0x03, 0x55, 0x04,
	0x03, 0x13, 0x0a, 0x47, 0x6c, 0x6f, 0x62, 0x61, 0x6c, 0x53, 0x69, 0x67,
	0x6e, 0x30, 0x82, 0x01, 0x22, 0x30, 0x0d, 0x06, 0x09, 0x2a, 0x86, 0x48,
	0x86, 0xf7, 0x0d, 0x01, 0x01, 0x01, 0x05, 0x00, 0x03, 0x82, 0x01, 0x0f,
	0x00, 0x30, 0x82, 0x01, 0x0a, 0x02, 0x82, 0x01, 0x01, 0x00, 0xcc, 0x25,
	0x76, 0x90, 0x79, 0x06, 0x78, 0x22, 0x16, 0xf5, 0xc0, 0x83, 0xb6, 0x84,
	0xca, 0x28, 0x9e, 0xfd, 0x05, 0x76, 0x11, 0xc5, 0xad, 0x88, 0x72, 0xfc,
	0x46, 0x02, 0x43, 0xc7, 0xb2, 0x8a, 0x9d, 0x04, 0x5f, 0x24, 0xcb, 0x2e,
	0x4b, 0xe1, 0x60, 0x82, 0x46, 0xe1, 0x52, 0xab, 0x0c, 0x81, 0x47, 0x70,
	0x6c, 0xdd, 0x64, 0xd1, 0xeb, 0xf5, 0x2c, 0xa3, 0x0f, 0x82, 0x3d, 0x0c,
	0x2b, 0xae, 0x97, 0xd7, 0xb6, 0x14, 0x86, 0x10, 0x79, 0xbb, 0x3b, 0x13,
	0x80, 0x77, 0x8c, 0x08, 0xe1, 0x49, 0xd2, 0x6a, 0x62, 0x2f, 0x1f, 0x5e,
	0xfa, 0x96, 0x68, 0xdf, 0x89, 0x27, 0x95, 0x38, 0x9f, 0x06, 0xd7, 0x3e,
	0xc9, 0xcb, 0x26, 0x59, 0x0d, 0x73, 0xde, 0xb0, 0xc8, 0xe9, 0x26, 0x0e,
	0x83, 0x15, 0xc6, 0xef, 0x5b, 0x8b, 0xd2, 0x04, 0x60, 0xca, 0x49, 0xa6,
	0x28, 0xf6, 0x69, 0x3b, 0xf6, 0xcb, 0xc8, 0x28, 0x91, 0xe5, 0x9d, 0x8a,
	0x61, 0x57, 0x37, 0xac, 0x74, 0x14, 0xdc, 0x74, 0xe0, 0x3a, 0xee, 0x72,
	0x2f, 0x2e, 0x9c, 0xfb, 0xd0, 0xbb, 0xbf, 0xf5, 0x3d, 0x00, 0xe1, 0x06,
	0x33, 0xe8, 0x82, 0x2b, 0xae, 0x53, 0xa6, 0x3a, 0x16, 0x73, 0x8c, 0xdd,
	0x41, 0x0e, 0x20, 0x3a, 0xc0, 0xb4, 0xa7, 0xa1, 0xe9, 0xb2, 0x4f, 0x90,
	0x2e, 0x32, 0x60, 0xe9, 0x57, 0xcb, 0xb9, 0x04, 0x92, 0x68, 0x68, 0xe5,
	0x38, 0x26, 0x60, 0x75, 0xb2, 0x9f, 0x77, 0xff, 0x91, 0x14, 0xef, 0xae,
	0x20, 0x49, 0xfc, 0xad, 0x40, 0x15, 0x48, 0xd1, 0x02, 0x31, 0x61, 0x19,
	0x5e, 0xb8, 0x97, 0xef, 0xad, 0x77, 0xb7, 0x64, 0x9a, 0x7a, 0xbf, 0x5f,
	0xc1, 0x13, 0xef, 0x9b, 0x62, 0xfb, 0x0d, 0x6c, 0xe0, 0x54, 0x69, 0x16,
	0xa9, 0x03, 0xda, 0x6e, 0xe9, 0x83, 0x93, 0x71, 0x76, 0xc6, 0x69, 0x85,
	0x82, 0x17, 0x02, 0x03, 0x01, 0x00, 0x01, 0xa3, 0x42, 0x30, 0x40, 0x30,
	0x0e, 0x06, 0x03, 0x55, 0x1d, 0x0f, 0x01, 0x01, 0xff, 0x04, 0x04, 0x03,
	0x02, 0x01, 0x06, 0x30, 0x0f, 0x06, 0x03, 0x55, 0x1d, 0x13, 0x01, 0x01,
	0xff, 0x04, 0x05, 0x30, 0x03, 0x01, 0x01, 0xff, 0x30, 0x1d, 0x06, 0x03,
	0x55, 0x1d, 0x0e, 0x04, 0x16, 0x04, 0x14, 0x8f, 0xf0, 0x4b, 0x7f, 0xa8,
	0x2e, 0x45, 0x24, 0xae, 0x4d, 0x50, 0xfa, 0x63, 0x9a, 0x8b, 0xde, 0xe2,
	0xdd, 0x1b, 0xbc, 0x30, 0x0d, 0x06, 0x09, 0x2a, 0x86, 0x48, 0x86, 0xf7,
	0x0d, 0x01, 0x01, 0x0b, 0x05, 0x00, 0x03, 0x82, 0x01, 0x01, 0x00, 0x4b,
	0x40, 0xdb, 0xc0, 0x50, 0xaa, 0xfe, 0xc8, 0x0c, 0xef, 0xf7, 0x96, 0x54,
	0x45, 0x49, 0xbb, 0x96, 0x00, 0x09, 0x41, 0xac, 0xb3, 0x13, 0x86, 0x86,
	0x28, 0x07, 0x33, 0xca, 0x6b, 0xe6, 0x74, 0xb9, 0xba, 0x00, 0x2d, 0xae,
	0xa4, 0x0a, 0xd3, 0xf5, 0xf1, 0xf1, 0x0f, 0x8a, 0xbf, 0x73, 0x67, 0x4a,
	0x83, 0xc7, 0x44, 0x7b, 0x78, 0xe0, 0xaf, 0x6e, 0x6c, 0x6f, 0x03, 0x29,
	0x8e, 0x33, 0x39, 0x45, 0xc3, 0x8e, 0xe4, 0xb9, 0x57, 0x6c, 0xaa, 0xfc,
	0x12, 0x96, 0xec, 0x53, 0xc6, 0x2d, 0xe4, 0x24, 0x6c, 0xb9, 0x94, 0x63,
	0xfb, 0xdc, 0x53, 0x68, 0x67, 0x56, 0x3e, 0x83, 0xb8, 0xcf, 0x35, 0x21,
	0xc3, 0xc9, 0x68, 0xfe, 0xce, 0xda, 0xc2, 0x53, 0xaa, 0xcc, 0x90, 0x8a,
	0xe9, 0xf0, 0x5d, 0x46, 0x8c, 0x95, 0xdd, 0x7a, 0x58, 0x28, 0x1a, 0x2f,
	0x1d, 0xde, 0xcd, 0x00, 0x37, 0x41, 0x8f, 0xed, 0x44, 0x6d, 0xd7, 0x53,
	0x28, 0x97, 0x7e, 0xf3, 0x67, 0x04, 0x1e, 0x15, 0xd7, 0x8a, 0x96, 0xb4,
	0xd3, 0xde, 0x4c, 0x27, 0xa4, 0x4c, 0x1b, 0x73, 0x73, 0x76, 0xf4, 0x17,
	0x99, 0xc2, 0x1f, 0x7a, 0x0e, 0xe3, 0x2d, 0x08, 0xad, 0x0a, 0x1c, 0x2c,
	0xff, 0x3c, 0xab, 0x55, 0x0e, 0x0f, 0x91, 0x7e, 0x36, 0xeb, 0xc3, 0x57,
	0x49, 0xbe, 0xe1, 0x2e, 0x2d, 0x7c, 0x60, 0x8b, 0xc3, 0x41, 0x51, 0x13,
	0x23, 0x9d, 0xce, 0xf7, 0x32, 0x6b, 0x94, 0x01, 0xa8, 0x99, 0xe7, 0x2c,
	0x33, 0x1f, 0x3a, 0x3b, 0x25, 0xd2, 0x86, 0x40, 0xce, 0x3b, 0x2c, 0x86,
	0x78, 0xc9, 0x61, 0x2f, 0x14, 0xba, 0xee, 0xdb, 0x55, 0x6f, 0xdf, 0x84,
	0xee, 0x05, 0x09, 0x4d, 0xbd, 0x28, 0xd8, 0x72, 0xce, 0xd3, 0x62, 0x50,
	0x65, 0x1e, 0xeb, 0x92, 0x97, 0x83, 0x31, 0xd9, 0xb3, 0xb5, 0xca, 0x47,
	0x58, 0x3f, 0x5f,
};

#endif /* CA_CERTIFICATE_H */
```
