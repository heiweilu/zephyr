## CMakeLists.txt
```
# Face recognize firmware for CHD-ESP32-S3-BOX
#
# Phase 0: live preview + WiFi connect (verify LCD-CAM coexistence)
# Phase 1+: HTTP/TLS to Aliyun bailian qwen-vl-plus

cmake_minimum_required(VERSION 3.20.0)
find_package(Zephyr REQUIRED HINTS $ENV{ZEPHYR_BASE})
project(face_recognize)

target_sources(app PRIVATE
	src/main.c
	src/jpeg_enc.c
	src/ai_client.c
	src/audio.c
	src/tts_client.c
)
```

## prj.conf
```kconfig
# Face recognize firmware: Camera + WiFi (NO BT, NO audio).
# Phase 0 goal: verify WiFi coexists with LCD-CAM peripheral.

# ── Display + LVGL (small footprint, just for status text overlay) ──
CONFIG_DISPLAY=y
CONFIG_LVGL=y
CONFIG_LV_USE_LOG=n
CONFIG_LV_Z_MEM_POOL_SIZE=32768
CONFIG_LV_Z_VDB_SIZE=20
CONFIG_LV_Z_BITS_PER_PIXEL=16
CONFIG_LV_COLOR_16_SWAP=y
CONFIG_LV_USE_LABEL=y
CONFIG_LV_FONT_MONTSERRAT_14=y

# ── SPI for LCD ──
CONFIG_SPI=y
CONFIG_MIPI_DBI=y

# ── I2C for OV3660 sensor config ──
CONFIG_I2C=y

# ── GPIO for BOOT button ──
CONFIG_GPIO=y
CONFIG_GPIO_INIT_PRIORITY=40

# ── Video subsystem ──
CONFIG_VIDEO=y
CONFIG_VIDEO_LOG_LEVEL_INF=y
CONFIG_VIDEO_BUFFER_USE_SHARED_MULTI_HEAP=y
CONFIG_VIDEO_BUFFER_SMH_ATTRIBUTE=2
CONFIG_VIDEO_BUFFER_POOL_NUM_MAX=4
CONFIG_VIDEO_BUFFER_POOL_SZ_MAX=153600
CONFIG_VIDEO_ESP32_DMA_BUFFER_MAX_SIZE=4092
CONFIG_VIDEO_OV3660=y
CONFIG_VIDEO_OV3660_COLOR_BAR_TEST=n

# ── DMA for LCD-CAM ──
CONFIG_DMA=y
CONFIG_DMA_ESP32_MAX_DESCRIPTOR_NUM=64

# ── I2S (audio TX/RX via ES8311 + ES7210) ──
CONFIG_I2S=y

# ── PSRAM ──
CONFIG_ESP_SPIRAM=y
CONFIG_SHARED_MULTI_HEAP=y
CONFIG_ESP_SPIRAM_HEAP_SIZE=4194304

# ── Networking ──
CONFIG_NETWORKING=y
CONFIG_NET_MGMT=y
CONFIG_NET_MGMT_EVENT=y
CONFIG_NET_MGMT_EVENT_INFO=y
CONFIG_NET_IPV4=y
CONFIG_NET_IPV6=n
CONFIG_NET_TCP=y
CONFIG_NET_UDP=y
CONFIG_NET_DHCPV4=y
CONFIG_NET_SOCKETS=y
CONFIG_POSIX_API=y

# ── TLS (mbedTLS) for HTTPS to dashscope.aliyuncs.com ──
CONFIG_NET_SOCKETS_SOCKOPT_TLS=y
CONFIG_TLS_CREDENTIALS=y
CONFIG_MBEDTLS=y
CONFIG_MBEDTLS_BUILTIN=y
CONFIG_MBEDTLS_SSL_MAX_CONTENT_LEN=16384
CONFIG_MBEDTLS_TLS_VERSION_1_2=y
CONFIG_MBEDTLS_SERVER_NAME_INDICATION=y
CONFIG_MBEDTLS_ENTROPY_C=y
CONFIG_MBEDTLS_SHA256=y
CONFIG_MBEDTLS_SHA384=y
CONFIG_MBEDTLS_SHA512=y
CONFIG_MBEDTLS_MD=y
CONFIG_MBEDTLS_ASN1_PARSE_C=y
CONFIG_MBEDTLS_KEY_EXCHANGE_RSA_ENABLED=y
CONFIG_MBEDTLS_KEY_EXCHANGE_ECDHE_RSA_ENABLED=y
CONFIG_MBEDTLS_KEY_EXCHANGE_ECDHE_ECDSA_ENABLED=y
CONFIG_MBEDTLS_CIPHER_AES_ENABLED=y
CONFIG_MBEDTLS_CIPHER_GCM_ENABLED=y
CONFIG_MBEDTLS_ECP_C=y
CONFIG_MBEDTLS_ECDH_C=y
CONFIG_MBEDTLS_ECDSA_C=y
CONFIG_MBEDTLS_ECP_DP_SECP256R1_ENABLED=y
CONFIG_MBEDTLS_ECP_DP_SECP384R1_ENABLED=y
CONFIG_MBEDTLS_RSA_C=y
CONFIG_MBEDTLS_PEM_CERTIFICATE_FORMAT=y
CONFIG_MBEDTLS_PKCS1_V15=y

# ── WiFi (PSRAM alloc to keep DRAM free) ──
CONFIG_WIFI=y
CONFIG_WIFI_NM=y
CONFIG_NET_L2_WIFI_MGMT=y
CONFIG_ESP32_WIFI_STA_AUTO_DHCPV4=y
CONFIG_ESP32_WIFI_STATIC_RX_BUFFER_NUM=4
CONFIG_ESP32_WIFI_DYNAMIC_RX_BUFFER_NUM=8
CONFIG_ESP32_WIFI_DYNAMIC_TX_BUFFER_NUM=8
CONFIG_ESP32_WIFI_NET_ALLOC_SPIRAM=y
CONFIG_ESP_WIFI_HEAP_SPIRAM=y

# ── DNS ──
CONFIG_DNS_RESOLVER=y
CONFIG_DNS_RESOLVER_AI_MAX_ENTRIES=2

# ── Logging ──
CONFIG_LOG=y
CONFIG_LOG_DEFAULT_LEVEL=3
CONFIG_PRINTK=y
# Bypass LOG ring for printk so JPEG hex dump can't be dropped.
CONFIG_LOG_PRINTK=n
# Use synchronous log so OV3660 init logs don't get dropped either.
CONFIG_LOG_MODE_IMMEDIATE=y
CONFIG_SERIAL=y

# ── Stack & buffers ──
CONFIG_MAIN_STACK_SIZE=8192
CONFIG_HEAP_MEM_POOL_SIZE=65536
CONFIG_SYSTEM_WORKQUEUE_STACK_SIZE=4096
CONFIG_NET_TX_STACK_SIZE=1024
CONFIG_NET_RX_STACK_SIZE=1024
CONFIG_NET_MGMT_EVENT_STACK_SIZE=4096
CONFIG_NET_PKT_RX_COUNT=24
CONFIG_NET_PKT_TX_COUNT=10
CONFIG_NET_BUF_RX_COUNT=64
CONFIG_NET_BUF_TX_COUNT=24
CONFIG_NET_MAX_CONTEXTS=6
```

## src/main.c
```c
/*
 * Face recognize firmware — Step 1a (Option C dynamic switching skeleton).
 *
 * State machine (driven by BOOT button):
 *   MODE_LIVE        : camera streaming, WiFi off, LCD shows preview
 *      └─ BOOT short ──▶ MODE_UPLOADING
 *   MODE_UPLOADING   : cam stopped, WiFi connecting/connected, blue LCD
 *      └─ wifi up + 2s ──▶ MODE_RESULT (Phase 1b will replace 2s with HTTP POST)
 *   MODE_RESULT      : WiFi up but idle, LCD shows captured snapshot
 *      └─ BOOT short ──▶ MODE_LIVE (cam restart, WiFi down)
 *
 * Phase 1b will add: OV3660 JPEG mode, base64 encode, TLS, HTTPS POST to
 * Aliyun bailian qwen-vl-plus, JSON parse + LVGL result text overlay.
 */

#include <zephyr/kernel.h>
#include <zephyr/device.h>
#include <zephyr/drivers/display.h>
#include <zephyr/drivers/gpio.h>
#include <zephyr/drivers/video.h>
#include <zephyr/sys/printk.h>
#include <zephyr/net/net_if.h>
#include <zephyr/net/net_mgmt.h>
#include <zephyr/net/wifi_mgmt.h>
#include <zephyr/logging/log.h>
#include <string.h>

#include "secrets.h"
#include "jpeg_enc.h"
#include "ai_client.h"
#include "audio.h"
#include "tts_client.h"

/* Step 1b-1a: encode a synthetic gradient at boot, dump JPEG hex over UART.
 * Set to 0 to skip (re-enable normal LIVE mode without delay). */
#define JPEG_SELFTEST 0

LOG_MODULE_REGISTER(face_recog, LOG_LEVEL_INF);

#define CAM_W        320
#define CAM_H        240
#define CAM_BPP      2
#define CAM_BYTES    (CAM_W * CAM_H * CAM_BPP)
#define CAM_BUF_NUM  2
#define BL_PIN       (47 - 32)
#define BTN_STACK    1024
#define MAIN_STACK   8192
#define DEBOUNCE_MS  30
#define LONG_PRESS_MS 1500

enum mode {
	MODE_LIVE = 0,
	MODE_UPLOADING,
	MODE_RESULT,
};

static volatile enum mode g_mode = MODE_LIVE;
static volatile bool      g_btn_event;

/* PSRAM-backed snapshot of the last frame captured by the user. */
static uint8_t snapshot[CAM_BYTES] __attribute__((section(".ext_ram.bss"), aligned(4)));
/* Pre-filled solid-blue full-screen buffer for the UPLOADING state. */
static uint8_t blue_screen[CAM_BYTES] __attribute__((section(".ext_ram.bss"), aligned(4)));

/* PSRAM scratch for RGB565→RGB888 conversion + JPEG output of the snapshot.
 * Always allocated (selftest reuses the same backing pages via overlap if
 * JPEG_SELFTEST is enabled — but selftest is now off by default). */
#define SNAP_RGB888_BYTES  (CAM_W * CAM_H * 3)
#define SNAP_JPEG_BYTES    (48 * 1024)
static uint8_t snap_rgb888[SNAP_RGB888_BYTES]
	__attribute__((section(".ext_ram.bss"), aligned(4)));
static uint8_t snap_jpeg[SNAP_JPEG_BYTES]
	__attribute__((section(".ext_ram.bss"), aligned(4)));

/* Convert one RGB565 (big-endian, as written by LCD-CAM DMA) frame to RGB888
 * and run jpeg_enc on it.  Dumps the JPEG hex over UART between the same
 * JPEG_BEGIN/JPEG_END markers used by the selftest, so the host tools
 * (capture_selftest.py + hex_to_jpg.ps1) work unchanged. */
static int dump_snapshot_as_jpeg(int quality)
{
	const uint8_t *src = snapshot;
	uint8_t *dst = snap_rgb888;
	for (int i = 0; i < CAM_W * CAM_H; i++) {
		uint8_t hi = src[2 * i + 0];
		uint8_t lo = src[2 * i + 1];
		uint16_t p = ((uint16_t)hi << 8) | lo;
		uint8_t r5 = (p >> 11) & 0x1F;
		uint8_t g6 = (p >> 5)  & 0x3F;
		uint8_t b5 =  p        & 0x1F;
		dst[3 * i + 0] = (uint8_t)((r5 << 3) | (r5 >> 2));
		dst[3 * i + 1] = (uint8_t)((g6 << 2) | (g6 >> 4));
		dst[3 * i + 2] = (uint8_t)((b5 << 3) | (b5 >> 2));
	}

	int64_t t0 = k_uptime_get();
	int n = jpeg_encode_rgb888(snap_jpeg, SNAP_JPEG_BYTES,
				   snap_rgb888, CAM_W, CAM_H, quality);
	int64_t dt = k_uptime_get() - t0;

	printk("\n=== JPEG SNAPSHOT ===\n");
	printk("encode result=%d bytes, took %lld ms (q=%d)\n", n, dt, quality);
	if (n <= 0) {
		printk("=== JPEG SNAPSHOT FAILED ===\n");
		return n;
	}
	printk("JPEG_BEGIN size=%d\n", n);
	for (int i = 0; i < n; i++) {
		printk("%02x", snap_jpeg[i]);
		if ((i % 32) == 31) {
			printk("\n");
		}
	}
	if ((n % 32) != 0) {
		printk("\n");
	}
	printk("JPEG_END\n=== JPEG SNAPSHOT DONE ===\n\n");
	return n;
}

#if JPEG_SELFTEST
/* RGB888 test pattern + JPEG output (PSRAM-backed). */
#define SELFTEST_RGB_BYTES  (CAM_W * CAM_H * 3)
#define SELFTEST_JPG_BYTES  (48 * 1024)
static uint8_t selftest_rgb[SELFTEST_RGB_BYTES]
	__attribute__((section(".ext_ram.bss"), aligned(4)));
static uint8_t selftest_jpg[SELFTEST_JPG_BYTES]
	__attribute__((section(".ext_ram.bss"), aligned(4)));

static void jpeg_selftest(void)
{
	/* Gradient: R = x ramp, G = y ramp, B = combined diagonal */
	for (int y = 0; y < CAM_H; y++) {
		for (int x = 0; x < CAM_W; x++) {
			uint8_t *p = &selftest_rgb[(y * CAM_W + x) * 3];
			p[0] = (uint8_t)(x * 255 / (CAM_W - 1));
			p[1] = (uint8_t)(y * 255 / (CAM_H - 1));
			p[2] = (uint8_t)(((x + y) * 255) / (CAM_W + CAM_H - 2));
		}
	}
	int64_t t0 = k_uptime_get();
	int n = jpeg_encode_rgb888(selftest_jpg, SELFTEST_JPG_BYTES,
				   selftest_rgb, CAM_W, CAM_H, 50);
	int64_t dt = k_uptime_get() - t0;

	printk("\n=== JPEG SELFTEST ===\n");
	printk("encode result=%d bytes, took %lld ms\n", n, dt);
	if (n <= 0) {
		printk("=== JPEG SELFTEST FAILED ===\n");
		return;
	}
	printk("JPEG_BEGIN size=%d\n", n);
	for (int i = 0; i < n; i++) {
		printk("%02x", selftest_jpg[i]);
		if ((i % 32) == 31) {
			printk("\n");
		}
	}
	if ((n % 32) != 0) {
		printk("\n");
	}
	printk("JPEG_END\n=== JPEG SELFTEST DONE ===\n\n");
}
#endif /* JPEG_SELFTEST */

/* ── Camera buffers ── */
static struct video_buffer *frame_buffers[CAM_BUF_NUM];

/* ── BOOT button (sw0) ── */
static const struct gpio_dt_spec boot_btn = GPIO_DT_SPEC_GET(DT_ALIAS(sw0), gpios);
static K_THREAD_STACK_DEFINE(btn_stack, BTN_STACK);
static struct k_thread btn_thread;

static void btn_thread_entry(void *p1, void *p2, void *p3)
{
	bool was_pressed = false;
	int64_t press_start = 0;

	if (!gpio_is_ready_dt(&boot_btn)) {
		LOG_ERR("BOOT button not ready");
		return;
	}
	gpio_pin_configure_dt(&boot_btn, GPIO_INPUT);

	while (1) {
		bool pressed = gpio_pin_get_dt(&boot_btn) == 1;
		int64_t now  = k_uptime_get();

		if (pressed && !was_pressed) {
			press_start = now;
			was_pressed = true;
		} else if (!pressed && was_pressed) {
			int64_t held = now - press_start;
			was_pressed = false;
			if (held < DEBOUNCE_MS) {
				/* glitch */
			} else if (held < LONG_PRESS_MS) {
				LOG_INF("BOOT short (%lldms) in mode=%d",
					held, (int)g_mode);
				g_btn_event = true;
			} else {
				LOG_INF("BOOT long (%lldms) — reserved", held);
			}
		}
		k_msleep(10);
	}
}

/* ── WiFi ── */

static struct net_if *sta_iface;
static struct net_mgmt_event_callback wifi_cb;
static struct net_mgmt_event_callback ipv4_cb;
static K_SEM_DEFINE(wifi_connected_sem, 0, 1);
static K_SEM_DEFINE(ipv4_ready_sem, 0, 1);
static K_SEM_DEFINE(scan_done_sem, 0, 1);
static bool wifi_cb_added;

static void wifi_evt(struct net_mgmt_event_callback *cb, uint64_t e, struct net_if *iface)
{
	ARG_UNUSED(iface);
	if (e == NET_EVENT_WIFI_SCAN_DONE) {
		k_sem_give(&scan_done_sem);
	} else if (e == NET_EVENT_WIFI_CONNECT_RESULT) {
		if (cb->info && cb->info_length == sizeof(struct wifi_status)) {
			const struct wifi_status *s = cb->info;
			if (s->status == WIFI_STATUS_CONN_SUCCESS) {
				LOG_INF("WiFi connected to %s", WIFI_SSID);
				k_sem_give(&wifi_connected_sem);
			} else {
				LOG_ERR("WiFi connect failed: %d", s->status);
			}
		}
	}
}

static void ipv4_evt(struct net_mgmt_event_callback *cb, uint64_t e, struct net_if *iface)
{
	ARG_UNUSED(cb); ARG_UNUSED(iface);
	if (e == NET_EVENT_IPV4_ADDR_ADD) {
		LOG_INF("IPv4 acquired");
		k_sem_give(&ipv4_ready_sem);
	}
}

static int wifi_up(void)
{
	struct wifi_connect_req_params p = {0};
	int ret;

	if (!sta_iface) {
		sta_iface = net_if_get_default();
	}
	if (!sta_iface) {
		return -ENODEV;
	}
	if (!wifi_cb_added) {
		net_mgmt_init_event_callback(&wifi_cb, wifi_evt,
			NET_EVENT_WIFI_SCAN_DONE | NET_EVENT_WIFI_CONNECT_RESULT |
			NET_EVENT_WIFI_DISCONNECT_RESULT);
		net_mgmt_add_event_callback(&wifi_cb);
		net_mgmt_init_event_callback(&ipv4_cb, ipv4_evt, NET_EVENT_IPV4_ADDR_ADD);
		net_mgmt_add_event_callback(&ipv4_cb);
		wifi_cb_added = true;
	}
	k_sem_reset(&wifi_connected_sem);
	k_sem_reset(&ipv4_ready_sem);
	k_sem_reset(&scan_done_sem);

	(void)net_if_up(sta_iface);

	LOG_INF("WiFi: scanning ...");
	for (int i = 0; i < 10; i++) {
		ret = net_mgmt(NET_REQUEST_WIFI_SCAN, sta_iface, NULL, 0);
		if (ret == 0) break;
		k_msleep(500);
	}
	if (ret) return ret;
	if (k_sem_take(&scan_done_sem, K_SECONDS(15))) return -ETIMEDOUT;

	p.ssid        = (const uint8_t *)WIFI_SSID;
	p.ssid_length = strlen(WIFI_SSID);
	p.psk         = (const uint8_t *)WIFI_PSK;
	p.psk_length  = strlen(WIFI_PSK);
	p.band        = WIFI_FREQ_BAND_UNKNOWN;
	p.channel     = WIFI_CHANNEL_ANY;
	p.security    = WIFI_SECURITY_TYPE_PSK;
	p.mfp         = WIFI_MFP_OPTIONAL;
	p.timeout     = SYS_FOREVER_MS;

	LOG_INF("WiFi: connecting to %s", WIFI_SSID);
	ret = net_mgmt(NET_REQUEST_WIFI_CONNECT, sta_iface, &p, sizeof(p));
	if (ret) return ret;
	if (k_sem_take(&wifi_connected_sem, K_SECONDS(30))) return -ETIMEDOUT;
	if (k_sem_take(&ipv4_ready_sem, K_SECONDS(30))) return -ETIMEDOUT;
	return 0;
}

static void wifi_down(void)
{
	if (!sta_iface) return;
	(void)net_mgmt(NET_REQUEST_WIFI_DISCONNECT, sta_iface, NULL, 0);
	(void)net_if_down(sta_iface);
	LOG_INF("WiFi: down");
}

/* ── Helpers: paint solid color / blit raw frame ── */

static void fill_screen_blue(const struct device *display_dev)
{
	struct display_buffer_descriptor d = {
		.buf_size = CAM_BYTES,
		.width    = CAM_W,
		.pitch    = CAM_W,
		.height   = CAM_H,
	};
	display_write(display_dev, 0, 0, &d, blue_screen);
}

static void blit_snapshot(const struct device *display_dev)
{
	struct display_buffer_descriptor d = {
		.buf_size = CAM_BYTES,
		.width    = CAM_W,
		.pitch    = CAM_W,
		.height   = CAM_H,
	};
	display_write(display_dev, 0, 0, &d, snapshot);
}

/* ── Camera control ── */

static int cam_start(const struct device *cam)
{
	for (int i = 0; i < CAM_BUF_NUM; i++) {
		int r = video_enqueue(cam, frame_buffers[i]);
		if (r < 0) {
			LOG_ERR("re-enqueue %d err %d", i, r);
			return r;
		}
	}
	return video_stream_start(cam, VIDEO_BUF_TYPE_OUTPUT);
}

static void cam_stop(const struct device *cam)
{
	(void)video_stream_stop(cam, VIDEO_BUF_TYPE_OUTPUT);
	/* Drain any in-flight buffers so the next start can re-enqueue cleanly. */
	struct video_buffer *b;
	while (video_dequeue(cam, &b, K_MSEC(50)) == 0) {
		/* discard */
	}
}

/* ── main: drives the state machine ── */

/* Step 1b-3a: 1kHz square-wave beep (0.5s @ 16kHz mono, 16-bit) */
#define BEEP_SAMPLES 8000
static int16_t beep_pcm[BEEP_SAMPLES] __attribute__((section(".ext_ram.bss")));

static void play_boot_beep(void)
{
	if (audio_codec_init() < 0) {
		LOG_WRN("audio_codec_init failed; skipping beep");
		return;
	}
	/* 1 kHz square wave: at 16 kHz that's 16 samples per period (8 hi / 8 lo) */
	for (int i = 0; i < BEEP_SAMPLES; i++) {
		beep_pcm[i] = ((i / 8) & 1) ? 8000 : -8000;
	}
	LOG_INF("playing 1kHz / 0.5s boot beep");
	audio_play(beep_pcm, BEEP_SAMPLES);
	LOG_INF("beep done");
}

int main(void)
{
	const struct device *const camera_dev  = DEVICE_DT_GET(DT_CHOSEN(zephyr_camera));
	const struct device *const display_dev = DEVICE_DT_GET(DT_CHOSEN(zephyr_display));
	const struct device *const gpio1       = DEVICE_DT_GET(DT_NODELABEL(gpio1));
	struct video_format fmt = {
		.type        = VIDEO_BUF_TYPE_OUTPUT,
		.pixelformat = VIDEO_PIX_FMT_RGB565,
		.width       = CAM_W,
		.height      = CAM_H,
		.pitch       = CAM_W * CAM_BPP,
	};
	int ret;

	printk("\n=== CHD-ESP32-S3-BOX Face Recognize firmware (Step 1a) ===\n");

	if (!device_is_ready(camera_dev) || !device_is_ready(display_dev)) {
		printk("device not ready\n");
		return 0;
	}
	if (device_is_ready(gpio1)) {
		gpio_pin_configure(gpio1, BL_PIN, GPIO_OUTPUT_ACTIVE);
		gpio_pin_set(gpio1, BL_PIN, 1);
	}
	display_blanking_off(display_dev);

	/* Step 1b-3a: ES8311 + I2S boot self-test */
	play_boot_beep();

	/* Pre-fill the solid-blue buffer (RGB565 BE: 0x001F LE -> 0x1F 00 BE) */
	for (int i = 0; i < CAM_BYTES; i += 2) {
		blue_screen[i]     = 0x00;
		blue_screen[i + 1] = 0x1F;
	}

#if JPEG_SELFTEST
	/* Give the host capture script time to (re)open USB-CDC after RST. */
	printk("\n[selftest will start in 5s — make sure capture script is running]\n");
	k_sleep(K_SECONDS(5));
	jpeg_selftest();
#endif

	if (video_set_format(camera_dev, &fmt) < 0 ||
	    video_get_format(camera_dev, &fmt) < 0) {
		printk("cam fmt err\n");
		return 0;
	}

	for (int i = 0; i < CAM_BUF_NUM; i++) {
		frame_buffers[i] = video_buffer_aligned_alloc(
			CAM_BYTES, CONFIG_VIDEO_BUFFER_POOL_ALIGN, K_FOREVER);
		if (!frame_buffers[i]) {
			printk("vbuf alloc %d failed\n", i);
			return 0;
		}
		frame_buffers[i]->type = VIDEO_BUF_TYPE_OUTPUT;
	}

	k_thread_create(&btn_thread, btn_stack, BTN_STACK,
			btn_thread_entry, NULL, NULL, NULL,
			K_PRIO_PREEMPT(8), 0, K_NO_WAIT);
	k_thread_name_set(&btn_thread, "btn");

	if (cam_start(camera_dev) < 0) {
		printk("cam_start initial failed\n");
		return 0;
	}
	LOG_INF("Mode = LIVE");

	struct video_buffer *captured = NULL;
	bool have_snapshot = false;

	for (uint32_t frame = 0; ; frame++) {
		/* Handle button events first */
		if (g_btn_event) {
			g_btn_event = false;
			if (g_mode == MODE_LIVE) {
				/* Take snapshot from the most recently displayed buffer */
				if (captured) {
					memcpy(snapshot, captured->buffer, CAM_BYTES);
					have_snapshot = true;
					LOG_INF("Snapshot saved (%d B)", CAM_BYTES);
				}
				cam_stop(camera_dev);
				captured = NULL;

				LOG_INF("Mode LIVE → UPLOADING");
				g_mode = MODE_UPLOADING;
				fill_screen_blue(display_dev);

				/* Step 1b-1b: encode the snapshot RIGHT HERE (cam stopped,
				 * WiFi not up yet → safe LCD-CAM, deterministic timing). */
				int jpeg_len = 0;
				if (have_snapshot) {
					jpeg_len = dump_snapshot_as_jpeg(50);
				}

				ret = wifi_up();
				if (ret) {
					LOG_ERR("wifi_up failed: %d, skipping POST", ret);
				} else if (jpeg_len > 0) {
					/* Phase 1b-2: POST jpeg to qwen-vl-plus, dump response. */
					if (ai_client_init() == 0) {
						int pr = ai_client_post_jpeg(snap_jpeg, jpeg_len);
						if (pr < 0) {
							LOG_ERR("ai_client_post_jpeg failed: %d", pr);
						} else {
							/* Phase 1b-3b: speak the caption via CosyVoice TTS */
							static char caption[512];
							int n = ai_client_get_caption(caption, sizeof(caption));
							if (n > 0) {
								LOG_INF("caption (%d B): %s", n, caption);
								int tr = tts_client_speak(caption);
								if (tr < 0) LOG_ERR("tts_client_speak: %d", tr);
							} else {
								LOG_WRN("no caption found in response");
							}
						}
					}
				}

				LOG_INF("Mode UPLOADING → RESULT");
				g_mode = MODE_RESULT;
				if (have_snapshot) {
					blit_snapshot(display_dev);
				}
			} else if (g_mode == MODE_RESULT) {
				LOG_INF("Mode RESULT → LIVE");
				wifi_down();
				if (cam_start(camera_dev) < 0) {
					LOG_ERR("cam_start failed");
				}
				g_mode = MODE_LIVE;
			}
			continue;
		}

		if (g_mode != MODE_LIVE) {
			k_msleep(50);
			continue;
		}

		/* LIVE: dequeue + display + re-enqueue */
		ret = video_dequeue(camera_dev, &captured, K_MSEC(200));
		if (ret < 0) {
			continue;
		}
		struct display_buffer_descriptor d = {
			.buf_size = captured->bytesused,
			.width    = fmt.width,
			.pitch    = fmt.width,
			.height   = captured->bytesused / fmt.pitch,
		};
		display_write(display_dev, 0, captured->line_offset, &d, captured->buffer);

		if ((frame % 60U) == 0U) {
			printk("[Cam] frame %u\n", frame);
		}
		(void)video_enqueue(camera_dev, captured);
	}
	return 0;
}
```

## src/ai_client.c
```c
/*
 * ai_client.c — POST JPEG to Aliyun bailian (qwen-vl-plus) via TLS.
 *
 * Phase 1b-2: build OpenAI-compatible chat-completions request with
 * data:image/jpeg;base64 payload, send via mbedTLS sockets, dump the
 * raw HTTP response to UART. JSON parsing is deferred to phase 1b-3.
 */

#include <zephyr/kernel.h>
#include <zephyr/logging/log.h>
#include <zephyr/net/socket.h>
#include <zephyr/net/tls_credentials.h>
#include <zephyr/net/dns_resolve.h>

#include <errno.h>
#include <stdio.h>
#include <string.h>

#include "ai_client.h"
#include "ca_cert.h"
#include "secrets.h"

LOG_MODULE_REGISTER(ai_client, LOG_LEVEL_INF);

#define AI_HOST       "dashscope.aliyuncs.com"
#define AI_PORT       "443"
#define AI_PATH       "/compatible-mode/v1/chat/completions"
#define AI_MODEL      "qwen-vl-plus"
#define AI_PROMPT     "请用一句中文描述图片里的人脸或主要内容。"

#define CA_TAG        1

/* PSRAM-backed scratch buffers (avoid blowing up DRAM). */
#define REQ_CAP       (24 * 1024)   /* HTTP headers + JSON + base64 jpeg */
#define RESP_CAP      (4 * 1024)    /* full HTTP response */
#define B64_CAP       (16 * 1024)   /* base64-encoded jpeg, ~4/3 of jpeg_len */

static uint8_t req_buf[REQ_CAP]   __attribute__((section(".ext_ram.bss")));
static uint8_t resp_buf[RESP_CAP] __attribute__((section(".ext_ram.bss")));
static uint8_t b64_buf[B64_CAP]   __attribute__((section(".ext_ram.bss")));

/* ── base64 ─────────────────────────────────────────────────────────── */
static const char b64_tbl[] =
	"ABCDEFGHIJKLMNOPQRSTUVWXYZabcdefghijklmnopqrstuvwxyz0123456789+/";

static int b64_encode(const uint8_t *in, size_t in_len, char *out, size_t out_cap)
{
	size_t need = ((in_len + 2) / 3) * 4 + 1; /* + NUL */
	if (need > out_cap) {
		return -ENOSPC;
	}

	size_t i, o = 0;
	for (i = 0; i + 3 <= in_len; i += 3) {
		uint32_t v = ((uint32_t)in[i] << 16) | ((uint32_t)in[i + 1] << 8) | in[i + 2];
		out[o++] = b64_tbl[(v >> 18) & 0x3F];
		out[o++] = b64_tbl[(v >> 12) & 0x3F];
		out[o++] = b64_tbl[(v >> 6) & 0x3F];
		out[o++] = b64_tbl[v & 0x3F];
	}
	size_t rem = in_len - i;
	if (rem == 1) {
		uint32_t v = (uint32_t)in[i] << 16;
		out[o++] = b64_tbl[(v >> 18) & 0x3F];
		out[o++] = b64_tbl[(v >> 12) & 0x3F];
		out[o++] = '=';
		out[o++] = '=';
	} else if (rem == 2) {
		uint32_t v = ((uint32_t)in[i] << 16) | ((uint32_t)in[i + 1] << 8);
		out[o++] = b64_tbl[(v >> 18) & 0x3F];
		out[o++] = b64_tbl[(v >> 12) & 0x3F];
		out[o++] = b64_tbl[(v >> 6) & 0x3F];
		out[o++] = '=';
	}
	out[o] = '\0';
	return (int)o;
}

/* ── TLS credential init ────────────────────────────────────────────── */
int ai_client_init(void)
{
	int ret = tls_credential_add(CA_TAG, TLS_CREDENTIAL_CA_CERTIFICATE,
				     ca_cert_globalsign_r3,
				     sizeof(ca_cert_globalsign_r3));
	if (ret < 0 && ret != -EEXIST) {
		LOG_ERR("tls_credential_add failed: %d", ret);
		return ret;
	}
	LOG_INF("CA cert registered (tag=%d, %u bytes)",
		CA_TAG, (unsigned)sizeof(ca_cert_globalsign_r3));
	return 0;
}

/* ── DNS + TCP connect ──────────────────────────────────────────────── */
static int connect_tls(void)
{
	struct zsock_addrinfo hints = {
		.ai_family = AF_INET,
		.ai_socktype = SOCK_STREAM,
	};
	struct zsock_addrinfo *res = NULL;

	int ret = zsock_getaddrinfo(AI_HOST, AI_PORT, &hints, &res);
	if (ret != 0 || res == NULL) {
		LOG_ERR("getaddrinfo(%s) failed: %d", AI_HOST, ret);
		return -EHOSTUNREACH;
	}

	int sock = zsock_socket(res->ai_family, res->ai_socktype, IPPROTO_TLS_1_2);
	if (sock < 0) {
		LOG_ERR("socket() failed: %d", -errno);
		zsock_freeaddrinfo(res);
		return -errno;
	}

	sec_tag_t sec_tag_list[] = { CA_TAG };
	if (zsock_setsockopt(sock, SOL_TLS, TLS_SEC_TAG_LIST,
			     sec_tag_list, sizeof(sec_tag_list)) < 0) {
		LOG_ERR("TLS_SEC_TAG_LIST failed: %d", -errno);
		zsock_close(sock);
		zsock_freeaddrinfo(res);
		return -errno;
	}
	if (zsock_setsockopt(sock, SOL_TLS, TLS_HOSTNAME,
			     AI_HOST, strlen(AI_HOST)) < 0) {
		LOG_ERR("TLS_HOSTNAME failed: %d", -errno);
		zsock_close(sock);
		zsock_freeaddrinfo(res);
		return -errno;
	}

	int verify = TLS_PEER_VERIFY_REQUIRED;
	if (zsock_setsockopt(sock, SOL_TLS, TLS_PEER_VERIFY,
			     &verify, sizeof(verify)) < 0) {
		LOG_WRN("TLS_PEER_VERIFY failed: %d", -errno);
	}

	LOG_INF("connecting to %s:%s ...", AI_HOST, AI_PORT);
	if (zsock_connect(sock, res->ai_addr, res->ai_addrlen) < 0) {
		LOG_ERR("connect() failed: %d", -errno);
		zsock_close(sock);
		zsock_freeaddrinfo(res);
		return -errno;
	}
	zsock_freeaddrinfo(res);
	LOG_INF("TLS connected");
	return sock;
}

/* ── send all ───────────────────────────────────────────────────────── */
static int send_all(int sock, const uint8_t *buf, size_t len)
{
	size_t sent = 0;
	while (sent < len) {
		ssize_t n = zsock_send(sock, buf + sent, len - sent, 0);
		if (n < 0) {
			LOG_ERR("send() failed at %zu/%zu: %d", sent, len, -errno);
			return -errno;
		}
		sent += n;
	}
	return 0;
}

/* ── public API ─────────────────────────────────────────────────────── */
int ai_client_post_jpeg(const uint8_t *jpeg, size_t jpeg_len)
{
	int b64_len = b64_encode(jpeg, jpeg_len, (char *)b64_buf, B64_CAP);
	if (b64_len < 0) {
		LOG_ERR("base64 encode failed: %d", b64_len);
		return b64_len;
	}
	LOG_INF("base64: %d bytes (jpeg=%zu)", b64_len, jpeg_len);

	/* Build JSON body in tail of req_buf so we know its length first. */
	char *body = (char *)req_buf + 4096;
	size_t body_cap = REQ_CAP - 4096;
	int body_len = snprintf(body, body_cap,
		"{\"model\":\"%s\","
		"\"messages\":[{\"role\":\"user\",\"content\":["
		"{\"type\":\"image_url\",\"image_url\":{\"url\":\"data:image/jpeg;base64,",
		AI_MODEL);
	if (body_len < 0 || (size_t)body_len >= body_cap) {
		return -ENOSPC;
	}
	if ((size_t)body_len + b64_len + 256 >= body_cap) {
		LOG_ERR("body buffer too small");
		return -ENOSPC;
	}
	memcpy(body + body_len, b64_buf, b64_len);
	body_len += b64_len;
	int tail = snprintf(body + body_len, body_cap - body_len,
		"\"}},{\"type\":\"text\",\"text\":\"%s\"}]}]}", AI_PROMPT);
	if (tail < 0) {
		return -ENOSPC;
	}
	body_len += tail;

	/* Build HTTP header at start of req_buf. */
	int hdr_len = snprintf((char *)req_buf, 4096,
		"POST %s HTTP/1.1\r\n"
		"Host: %s\r\n"
		"Authorization: Bearer %s\r\n"
		"Content-Type: application/json\r\n"
		"Content-Length: %d\r\n"
		"Connection: close\r\n"
		"\r\n",
		AI_PATH, AI_HOST, BAILIAN_API_KEY, body_len);
	if (hdr_len < 0 || hdr_len >= 4096) {
		return -ENOSPC;
	}

	int sock = connect_tls();
	if (sock < 0) {
		return sock;
	}

	int ret = send_all(sock, req_buf, hdr_len);
	if (ret == 0) {
		ret = send_all(sock, (const uint8_t *)body, body_len);
	}
	if (ret < 0) {
		zsock_close(sock);
		return ret;
	}
	LOG_INF("request sent (header=%d, body=%d)", hdr_len, body_len);

	/* Read full response into resp_buf, then dump. */
	size_t total = 0;
	while (total < RESP_CAP - 1) {
		ssize_t n = zsock_recv(sock, resp_buf + total, RESP_CAP - 1 - total, 0);
		if (n == 0) {
			break; /* EOF */
		}
		if (n < 0) {
			LOG_ERR("recv() failed: %d", -errno);
			ret = -errno;
			break;
		}
		total += n;
	}
	zsock_close(sock);
	resp_buf[total] = '\0';

	printk("AI_RESP_BEGIN size=%zu\n", total);
	/* Dump as text in chunks; printk handles \r\n fine. */
	const size_t chunk = 256;
	for (size_t i = 0; i < total; i += chunk) {
		size_t n = (total - i < chunk) ? (total - i) : chunk;
		uint8_t save = resp_buf[i + n];
		resp_buf[i + n] = '\0';
		printk("%s", (char *)(resp_buf + i));
		resp_buf[i + n] = save;
	}
	printk("\nAI_RESP_END\n");

	return ret;
}
```

## src/ai_client.h
```c
#ifndef AI_CLIENT_H_
#define AI_CLIENT_H_

#include <stddef.h>
#include <stdint.h>

/* Initialize TLS credential (register CA cert). Call once after wifi_up(). */
int ai_client_init(void);

/*
 * POST a JPEG image to Aliyun bailian (qwen-vl-plus, OpenAI-compatible).
 * The full HTTP response (status line + headers + body) is dumped to UART
 * via printk between AI_RESP_BEGIN / AI_RESP_END markers.
 *
 * Returns 0 on success (got an HTTP response), negative errno on failure.
 */
int ai_client_post_jpeg(const uint8_t *jpeg, size_t jpeg_len);

/*
 * Extract the qwen-vl-plus caption text from the most recent response
 * (i.e. the value of choices[0].message.content). Returns the number of
 * bytes written to `out` (excluding NUL terminator), 0 if not found.
 * Performs minimal JSON unescape of \", \\ and \n.
 */
int ai_client_get_caption(char *out, size_t out_max);

#endif /* AI_CLIENT_H_ */
```

## src/ca_cert.h
```c
/*
 * DigiCert Global Root G2
 * Used as TLS root CA for dashscope.aliyuncs.com (Aliyun bailian).
 * Source: https://cacerts.digicert.com/DigiCertGlobalRootG2.crt.pem
 */
#ifndef CA_CERT_H_
#define CA_CERT_H_

static const unsigned char ca_cert_digicert_g2[] =
"-----BEGIN CERTIFICATE-----\n"
"MIIDjjCCAnagAwIBAgIQAzrx5qcRqaC7KGSxHQn65TANBgkqhkiG9w0BAQsFADBh\n"
"MQswCQYDVQQGEwJVUzEVMBMGA1UEChMMRGlnaUNlcnQgSW5jMRkwFwYDVQQLExB3\n"
"d3cuZGlnaWNlcnQuY29tMSAwHgYDVQQDExdEaWdpQ2VydCBHbG9iYWwgUm9vdCBH\n"
"MjAeFw0xMzA4MDExMjAwMDBaFw0zODAxMTUxMjAwMDBaMGExCzAJBgNVBAYTAlVT\n"
"MRUwEwYDVQQKEwxEaWdpQ2VydCBJbmMxGTAXBgNVBAsTEHd3dy5kaWdpY2VydC5j\n"
"b20xIDAeBgNVBAMTF0RpZ2lDZXJ0IEdsb2JhbCBSb290IEcyMIIBIjANBgkqhkiG\n"
"9w0BAQEFAAOCAQ8AMIIBCgKCAQEAuzfNNNx7a8myaJCtSnX/RrohCgiN9RlUyfuI\n"
"2/Ou8jqJkTx65qsGGmvPrC3oXgkkRLpimn7Wo6h+4FR1IAWsULecYxpsMNzaHxmx\n"
"1x7e/dfgy5SDN67sH0NO3Xss0r0upS/kqbitOtSZpLYl6ZtrAGCSYP9PIUkY92eQ\n"
"q2EGnI/yuum06ZIya7XzV+hdG82MHauVBJVJ8zUtluNJbd134/tJS7SsVQepj5Wz\n"
"tCO7TG1F8PapspUwtP1MVYwnSlcUfIKdzXOS0xZKBgyMUNGPHgm+F6HmIcr9g+UQ\n"
"vIOlCsRnKPZzFBQ9RnbDhxSJITRNrw9FDKZJobq7nMWxM4MphQIDAQABo0IwQDAP\n"
"BgNVHRMBAf8EBTADAQH/MA4GA1UdDwEB/wQEAwIBhjAdBgNVHQ4EFgQUTiJUIBiV\n"
"5uNu5g/6+rkS7QYXjzkwDQYJKoZIhvcNAQELBQADggEBAGBnKJRvDkhj6zHd6mcY\n"
"1Yl9PMWLSn/pvtsrF9+wX3N3KjITOYFnQoQj8kVnNeyIv/iPsGEMNKSuIEyExtv4\n"
"NeF22d+mQrvHRAiGfzZ0JFrabA0UWTW98kndth/Jsw1HKj2ZL7tcu7XUIOGZX1NG\n"
"Fdtom/DzMNU+MeKNhJ7jitralj41E6Vf8PlwUHBHQRFXGU7Aj64GxJUTFy8bJZ91\n"
"8rGOmaFvE7FBcf6IKshPECBV1/MUReXgRPTqh5Uykw7+U0b6LJ3/iyK5S9kJRaTe\n"
"pLiaWN0bfVKfjllDiIGknibVb63dDcY3fe0Dkhvld1927jyNxF1WW6LZZm6zNTfl\n"
"MrY=\n"
"-----END CERTIFICATE-----\n";

#endif /* CA_CERT_H_ */
```

## src/jpeg_enc.c
```c
/*
 * jpeg_enc.c — in-memory port of Jon Olick's public-domain jo_jpeg.cpp v1.61.
 * Original: http://jonolick.com  (public domain)
 *
 * Differences vs upstream:
 *   - FILE* output replaced with a (uint8_t *out, int cap, int pos) buffer.
 *   - C++ kept-style const arrays converted to plain C.
 *   - Returns number of bytes written, or -1 on out-of-buffer.
 *   - Only RGB888 input supported (comp = 3).
 *   - Width/height must be multiples of 16 (we always use chroma subsampling).
 */

#include "jpeg_enc.h"
#include <math.h>
#include <string.h>

struct out_buf {
	uint8_t *buf;
	int      cap;
	int      pos;
	int      overflow;
};

static void put_u8(struct out_buf *o, uint8_t b)
{
	if (o->pos < o->cap) {
		o->buf[o->pos] = b;
	} else {
		o->overflow = 1;
	}
	o->pos++;
}

static void put_bytes(struct out_buf *o, const void *data, int len)
{
	const uint8_t *p = data;
	for (int i = 0; i < len; i++) {
		put_u8(o, p[i]);
	}
}

static const uint8_t s_jo_ZigZag[] = {
	 0, 1, 5, 6,14,15,27,28,
	 2, 4, 7,13,16,26,29,42,
	 3, 8,12,17,25,30,41,43,
	 9,11,18,24,31,40,44,53,
	10,19,23,32,39,45,52,54,
	20,22,33,38,46,51,55,60,
	21,34,37,47,50,56,59,61,
	35,36,48,49,57,58,62,63
};

static void jo_writeBits(struct out_buf *o, int *bitBuf, int *bitCnt,
			 const unsigned short *bs)
{
	*bitCnt += bs[1];
	*bitBuf |= bs[0] << (24 - *bitCnt);
	while (*bitCnt >= 8) {
		uint8_t c = (*bitBuf >> 16) & 255;
		put_u8(o, c);
		if (c == 255) {
			put_u8(o, 0);
		}
		*bitBuf <<= 8;
		*bitCnt -= 8;
	}
}

static void jo_DCT(float *d0, float *d1, float *d2, float *d3,
		   float *d4, float *d5, float *d6, float *d7)
{
	float tmp0 = *d0 + *d7;
	float tmp7 = *d0 - *d7;
	float tmp1 = *d1 + *d6;
	float tmp6 = *d1 - *d6;
	float tmp2 = *d2 + *d5;
	float tmp5 = *d2 - *d5;
	float tmp3 = *d3 + *d4;
	float tmp4 = *d3 - *d4;

	float tmp10 = tmp0 + tmp3;
	float tmp13 = tmp0 - tmp3;
	float tmp11 = tmp1 + tmp2;
	float tmp12 = tmp1 - tmp2;

	*d0 = tmp10 + tmp11;
	*d4 = tmp10 - tmp11;

	float z1 = (tmp12 + tmp13) * 0.707106781f;
	*d2 = tmp13 + z1;
	*d6 = tmp13 - z1;

	tmp10 = tmp4 + tmp5;
	tmp11 = tmp5 + tmp6;
	tmp12 = tmp6 + tmp7;

	float z5 = (tmp10 - tmp12) * 0.382683433f;
	float z2 = tmp10 * 0.541196100f + z5;
	float z4 = tmp12 * 1.306562965f + z5;
	float z3 = tmp11 * 0.707106781f;

	float z11 = tmp7 + z3;
	float z13 = tmp7 - z3;

	*d5 = z13 + z2;
	*d3 = z13 - z2;
	*d1 = z11 + z4;
	*d7 = z11 - z4;
}

static void jo_calcBits(int val, unsigned short bits[2])
{
	int tmp1 = val < 0 ? -val : val;
	val = val < 0 ? val - 1 : val;
	bits[1] = 1;
	while (tmp1 >>= 1) {
		++bits[1];
	}
	bits[0] = val & ((1 << bits[1]) - 1);
}

static int jo_processDU(struct out_buf *o, int *bitBuf, int *bitCnt,
			float *CDU, int du_stride, float *fdtbl, int DC,
			const unsigned short HTDC[256][2],
			const unsigned short HTAC[256][2])
{
	const unsigned short EOB[2]       = { HTAC[0x00][0], HTAC[0x00][1] };
	const unsigned short M16zeroes[2] = { HTAC[0xF0][0], HTAC[0xF0][1] };

	for (int i = 0; i < du_stride * 8; i += du_stride) {
		jo_DCT(&CDU[i], &CDU[i + 1], &CDU[i + 2], &CDU[i + 3],
		       &CDU[i + 4], &CDU[i + 5], &CDU[i + 6], &CDU[i + 7]);
	}
	for (int i = 0; i < 8; ++i) {
		jo_DCT(&CDU[i],                    &CDU[i + du_stride],
		       &CDU[i + du_stride * 2],    &CDU[i + du_stride * 3],
		       &CDU[i + du_stride * 4],    &CDU[i + du_stride * 5],
		       &CDU[i + du_stride * 6],    &CDU[i + du_stride * 7]);
	}

	int DU[64];
	for (int y = 0, j = 0; y < 8; ++y) {
		for (int x = 0; x < 8; ++x, ++j) {
			int i = y * du_stride + x;
			float v = CDU[i] * fdtbl[j];
			DU[s_jo_ZigZag[j]] = (int)(v < 0 ? ceilf(v - 0.5f)
						       : floorf(v + 0.5f));
		}
	}

	int diff = DU[0] - DC;
	if (diff == 0) {
		jo_writeBits(o, bitBuf, bitCnt, HTDC[0]);
	} else {
		unsigned short bits[2];
		jo_calcBits(diff, bits);
		jo_writeBits(o, bitBuf, bitCnt, HTDC[bits[1]]);
		jo_writeBits(o, bitBuf, bitCnt, bits);
	}

	int end0pos = 63;
	for (; end0pos > 0 && DU[end0pos] == 0; --end0pos) {
	}
	if (end0pos == 0) {
		jo_writeBits(o, bitBuf, bitCnt, EOB);
		return DU[0];
	}
	for (int i = 1; i <= end0pos; ++i) {
		int startpos = i;
		for (; DU[i] == 0 && i <= end0pos; ++i) {
		}
		int nrzeroes = i - startpos;
		if (nrzeroes >= 16) {
			int lng = nrzeroes >> 4;
			for (int nrmarker = 1; nrmarker <= lng; ++nrmarker) {
				jo_writeBits(o, bitBuf, bitCnt, M16zeroes);
			}
			nrzeroes &= 15;
		}
		unsigned short bits[2];
		jo_calcBits(DU[i], bits);
		jo_writeBits(o, bitBuf, bitCnt,
			     HTAC[(nrzeroes << 4) + bits[1]]);
		jo_writeBits(o, bitBuf, bitCnt, bits);
	}
	if (end0pos != 63) {
		jo_writeBits(o, bitBuf, bitCnt, EOB);
	}
	return DU[0];
}

static inline void jo_calcYUV(float *y, float *u, float *v,
			      uint8_t r, uint8_t g, uint8_t b)
{
	*y = +0.29900f * r + 0.58700f * g + 0.11400f * b - 128;
	*u = -0.16874f * r - 0.33126f * g + 0.50000f * b;
	*v = +0.50000f * r - 0.41869f * g - 0.08131f * b;
}

int jpeg_encode_rgb888(uint8_t *out, int out_cap,
		       const uint8_t *rgb, int width, int height, int quality)
{
	static const uint8_t std_dc_luminance_nrcodes[]   = {0,0,1,5,1,1,1,1,1,1,0,0,0,0,0,0,0};
	static const uint8_t std_dc_luminance_values[]    = {0,1,2,3,4,5,6,7,8,9,10,11};
	static const uint8_t std_ac_luminance_nrcodes[]   = {0,0,2,1,3,3,2,4,3,5,5,4,4,0,0,1,0x7d};
	static const uint8_t std_ac_luminance_values[] = {
		0x01,0x02,0x03,0x00,0x04,0x11,0x05,0x12,0x21,0x31,0x41,0x06,0x13,0x51,0x61,0x07,
		0x22,0x71,0x14,0x32,0x81,0x91,0xa1,0x08,0x23,0x42,0xb1,0xc1,0x15,0x52,0xd1,0xf0,
		0x24,0x33,0x62,0x72,0x82,0x09,0x0a,0x16,0x17,0x18,0x19,0x1a,0x25,0x26,0x27,0x28,
		0x29,0x2a,0x34,0x35,0x36,0x37,0x38,0x39,0x3a,0x43,0x44,0x45,0x46,0x47,0x48,0x49,
		0x4a,0x53,0x54,0x55,0x56,0x57,0x58,0x59,0x5a,0x63,0x64,0x65,0x66,0x67,0x68,0x69,
		0x6a,0x73,0x74,0x75,0x76,0x77,0x78,0x79,0x7a,0x83,0x84,0x85,0x86,0x87,0x88,0x89,
		0x8a,0x92,0x93,0x94,0x95,0x96,0x97,0x98,0x99,0x9a,0xa2,0xa3,0xa4,0xa5,0xa6,0xa7,
		0xa8,0xa9,0xaa,0xb2,0xb3,0xb4,0xb5,0xb6,0xb7,0xb8,0xb9,0xba,0xc2,0xc3,0xc4,0xc5,
		0xc6,0xc7,0xc8,0xc9,0xca,0xd2,0xd3,0xd4,0xd5,0xd6,0xd7,0xd8,0xd9,0xda,0xe1,0xe2,
		0xe3,0xe4,0xe5,0xe6,0xe7,0xe8,0xe9,0xea,0xf1,0xf2,0xf3,0xf4,0xf5,0xf6,0xf7,0xf8,
		0xf9,0xfa
	};
	static const uint8_t std_dc_chrominance_nrcodes[] = {0,0,3,1,1,1,1,1,1,1,1,1,0,0,0,0,0};
	static const uint8_t std_dc_chrominance_values[]  = {0,1,2,3,4,5,6,7,8,9,10,11};
	static const uint8_t std_ac_chrominance_nrcodes[] = {0,0,2,1,2,4,4,3,4,7,5,4,4,0,1,2,0x77};
	static const uint8_t std_ac_chrominance_values[] = {
		0x00,0x01,0x02,0x03,0x11,0x04,0x05,0x21,0x31,0x06,0x12,0x41,0x51,0x07,0x61,0x71,
		0x13,0x22,0x32,0x81,0x08,0x14,0x42,0x91,0xa1,0xb1,0xc1,0x09,0x23,0x33,0x52,0xf0,
		0x15,0x62,0x72,0xd1,0x0a,0x16,0x24,0x34,0xe1,0x25,0xf1,0x17,0x18,0x19,0x1a,0x26,
		0x27,0x28,0x29,0x2a,0x35,0x36,0x37,0x38,0x39,0x3a,0x43,0x44,0x45,0x46,0x47,0x48,
		0x49,0x4a,0x53,0x54,0x55,0x56,0x57,0x58,0x59,0x5a,0x63,0x64,0x65,0x66,0x67,0x68,
		0x69,0x6a,0x73,0x74,0x75,0x76,0x77,0x78,0x79,0x7a,0x82,0x83,0x84,0x85,0x86,0x87,
		0x88,0x89,0x8a,0x92,0x93,0x94,0x95,0x96,0x97,0x98,0x99,0x9a,0xa2,0xa3,0xa4,0xa5,
		0xa6,0xa7,0xa8,0xa9,0xaa,0xb2,0xb3,0xb4,0xb5,0xb6,0xb7,0xb8,0xb9,0xba,0xc2,0xc3,
		0xc4,0xc5,0xc6,0xc7,0xc8,0xc9,0xca,0xd2,0xd3,0xd4,0xd5,0xd6,0xd7,0xd8,0xd9,0xda,
		0xe2,0xe3,0xe4,0xe5,0xe6,0xe7,0xe8,0xe9,0xea,0xf2,0xf3,0xf4,0xf5,0xf6,0xf7,0xf8,
		0xf9,0xfa
	};
	static const unsigned short YDC_HT[256][2] = {
		{0,2},{2,3},{3,3},{4,3},{5,3},{6,3},{14,4},{30,5},{62,6},{126,7},{254,8},{510,9}
	};
	static const unsigned short UVDC_HT[256][2] = {
		{0,2},{1,2},{2,2},{6,3},{14,4},{30,5},{62,6},{126,7},{254,8},{510,9},{1022,10},{2046,11}
	};
	static const unsigned short YAC_HT[256][2] = {
		{10,4},{0,2},{1,2},{4,3},{11,4},{26,5},{120,7},{248,8},{1014,10},{65410,16},{65411,16},{0,0},{0,0},{0,0},{0,0},{0,0},{0,0},
		{12,4},{27,5},{121,7},{502,9},{2038,11},{65412,16},{65413,16},{65414,16},{65415,16},{65416,16},{0,0},{0,0},{0,0},{0,0},{0,0},{0,0},
		{28,5},{249,8},{1015,10},{4084,12},{65417,16},{65418,16},{65419,16},{65420,16},{65421,16},{65422,16},{0,0},{0,0},{0,0},{0,0},{0,0},{0,0},
		{58,6},{503,9},{4085,12},{65423,16},{65424,16},{65425,16},{65426,16},{65427,16},{65428,16},{65429,16},{0,0},{0,0},{0,0},{0,0},{0,0},{0,0},
		{59,6},{1016,10},{65430,16},{65431,16},{65432,16},{65433,16},{65434,16},{65435,16},{65436,16},{65437,16},{0,0},{0,0},{0,0},{0,0},{0,0},{0,0},
		{122,7},{2039,11},{65438,16},{65439,16},{65440,16},{65441,16},{65442,16},{65443,16},{65444,16},{65445,16},{0,0},{0,0},{0,0},{0,0},{0,0},{0,0},
		{123,7},{4086,12},{65446,16},{65447,16},{65448,16},{65449,16},{65450,16},{65451,16},{65452,16},{65453,16},{0,0},{0,0},{0,0},{0,0},{0,0},{0,0},
		{250,8},{4087,12},{65454,16},{65455,16},{65456,16},{65457,16},{65458,16},{65459,16},{65460,16},{65461,16},{0,0},{0,0},{0,0},{0,0},{0,0},{0,0},
		{504,9},{32704,15},{65462,16},{65463,16},{65464,16},{65465,16},{65466,16},{65467,16},{65468,16},{65469,16},{0,0},{0,0},{0,0},{0,0},{0,0},{0,0},
		{505,9},{65470,16},{65471,16},{65472,16},{65473,16},{65474,16},{65475,16},{65476,16},{65477,16},{65478,16},{0,0},{0,0},{0,0},{0,0},{0,0},{0,0},
		{506,9},{65479,16},{65480,16},{65481,16},{65482,16},{65483,16},{65484,16},{65485,16},{65486,16},{65487,16},{0,0},{0,0},{0,0},{0,0},{0,0},{0,0},
		{1017,10},{65488,16},{65489,16},{65490,16},{65491,16},{65492,16},{65493,16},{65494,16},{65495,16},{65496,16},{0,0},{0,0},{0,0},{0,0},{0,0},{0,0},
		{1018,10},{65497,16},{65498,16},{65499,16},{65500,16},{65501,16},{65502,16},{65503,16},{65504,16},{65505,16},{0,0},{0,0},{0,0},{0,0},{0,0},{0,0},
		{2040,11},{65506,16},{65507,16},{65508,16},{65509,16},{65510,16},{65511,16},{65512,16},{65513,16},{65514,16},{0,0},{0,0},{0,0},{0,0},{0,0},{0,0},
		{65515,16},{65516,16},{65517,16},{65518,16},{65519,16},{65520,16},{65521,16},{65522,16},{65523,16},{65524,16},{0,0},{0,0},{0,0},{0,0},{0,0},
		{2041,11},{65525,16},{65526,16},{65527,16},{65528,16},{65529,16},{65530,16},{65531,16},{65532,16},{65533,16},{65534,16},{0,0},{0,0},{0,0},{0,0},{0,0}
	};
	static const unsigned short UVAC_HT[256][2] = {
		{0,2},{1,2},{4,3},{10,4},{24,5},{25,5},{56,6},{120,7},{500,9},{1014,10},{4084,12},{0,0},{0,0},{0,0},{0,0},{0,0},{0,0},
		{11,4},{57,6},{246,8},{501,9},{2038,11},{4085,12},{65416,16},{65417,16},{65418,16},{65419,16},{0,0},{0,0},{0,0},{0,0},{0,0},{0,0},
		{26,5},{247,8},{1015,10},{4086,12},{32706,15},{65420,16},{65421,16},{65422,16},{65423,16},{65424,16},{0,0},{0,0},{0,0},{0,0},{0,0},{0,0},
		{27,5},{248,8},{1016,10},{4087,12},{65425,16},{65426,16},{65427,16},{65428,16},{65429,16},{65430,16},{0,0},{0,0},{0,0},{0,0},{0,0},{0,0},
		{58,6},{502,9},{65431,16},{65432,16},{65433,16},{65434,16},{65435,16},{65436,16},{65437,16},{65438,16},{0,0},{0,0},{0,0},{0,0},{0,0},{0,0},
		{59,6},{1017,10},{65439,16},{65440,16},{65441,16},{65442,16},{65443,16},{65444,16},{65445,16},{65446,16},{0,0},{0,0},{0,0},{0,0},{0,0},{0,0},
		{121,7},{2039,11},{65447,16},{65448,16},{65449,16},{65450,16},{65451,16},{65452,16},{65453,16},{65454,16},{0,0},{0,0},{0,0},{0,0},{0,0},{0,0},
		{122,7},{2040,11},{65455,16},{65456,16},{65457,16},{65458,16},{65459,16},{65460,16},{65461,16},{65462,16},{0,0},{0,0},{0,0},{0,0},{0,0},{0,0},
		{249,8},{65463,16},{65464,16},{65465,16},{65466,16},{65467,16},{65468,16},{65469,16},{65470,16},{65471,16},{0,0},{0,0},{0,0},{0,0},{0,0},{0,0},
		{503,9},{65472,16},{65473,16},{65474,16},{65475,16},{65476,16},{65477,16},{65478,16},{65479,16},{65480,16},{0,0},{0,0},{0,0},{0,0},{0,0},{0,0},
		{504,9},{65481,16},{65482,16},{65483,16},{65484,16},{65485,16},{65486,16},{65487,16},{65488,16},{65489,16},{0,0},{0,0},{0,0},{0,0},{0,0},{0,0},
		{505,9},{65490,16},{65491,16},{65492,16},{65493,16},{65494,16},{65495,16},{65496,16},{65497,16},{65498,16},{0,0},{0,0},{0,0},{0,0},{0,0},{0,0},
		{506,9},{65499,16},{65500,16},{65501,16},{65502,16},{65503,16},{65504,16},{65505,16},{65506,16},{65507,16},{0,0},{0,0},{0,0},{0,0},{0,0},{0,0},
		{2041,11},{65508,16},{65509,16},{65510,16},{65511,16},{65512,16},{65513,16},{65514,16},{65515,16},{65516,16},{0,0},{0,0},{0,0},{0,0},{0,0},{0,0},
		{16352,14},{65517,16},{65518,16},{65519,16},{65520,16},{65521,16},{65522,16},{65523,16},{65524,16},{65525,16},{0,0},{0,0},{0,0},{0,0},{0,0},
		{1018,10},{32707,15},{65526,16},{65527,16},{65528,16},{65529,16},{65530,16},{65531,16},{65532,16},{65533,16},{65534,16},{0,0},{0,0},{0,0},{0,0},{0,0}
	};
	static const int YQT[] = {
		16, 11, 10, 16, 24, 40, 51, 61,
		12, 12, 14, 19, 26, 58, 60, 55,
		14, 13, 16, 24, 40, 57, 69, 56,
		14, 17, 22, 29, 51, 87, 80, 62,
		18, 22, 37, 56, 68,109,103, 77,
		24, 35, 55, 64, 81,104,113, 92,
		49, 64, 78, 87,103,121,120,101,
		72, 92, 95, 98,112,100,103, 99
	};
	static const int UVQT[] = {
		17, 18, 24, 47, 99, 99, 99, 99,
		18, 21, 26, 66, 99, 99, 99, 99,
		24, 26, 56, 99, 99, 99, 99, 99,
		47, 66, 99, 99, 99, 99, 99, 99,
		99, 99, 99, 99, 99, 99, 99, 99,
		99, 99, 99, 99, 99, 99, 99, 99,
		99, 99, 99, 99, 99, 99, 99, 99,
		99, 99, 99, 99, 99, 99, 99, 99
	};
	static const float aasf[] = {
		1.0f          * 2.828427125f,
		1.387039845f  * 2.828427125f,
		1.306562965f  * 2.828427125f,
		1.175875602f  * 2.828427125f,
		1.0f          * 2.828427125f,
		0.785694958f  * 2.828427125f,
		0.541196100f  * 2.828427125f,
		0.275899379f  * 2.828427125f
	};

	if (!out || !rgb || width <= 0 || height <= 0 || (width & 15) || (height & 15)) {
		return -1;
	}

	struct out_buf o = { .buf = out, .cap = out_cap, .pos = 0, .overflow = 0 };

	int qf = quality ? quality : 90;
	int subsample = qf <= 90 ? 1 : 0;
	qf = qf < 1 ? 1 : qf > 100 ? 100 : qf;
	qf = qf < 50 ? 5000 / qf : 200 - qf * 2;

	uint8_t YTable[64], UVTable[64];
	for (int i = 0; i < 64; ++i) {
		int yti  = (YQT[i]  * qf + 50) / 100;
		YTable [s_jo_ZigZag[i]] = yti  < 1 ? 1 : yti  > 255 ? 255 : yti;
		int uvti = (UVQT[i] * qf + 50) / 100;
		UVTable[s_jo_ZigZag[i]] = uvti < 1 ? 1 : uvti > 255 ? 255 : uvti;
	}

	float fdtbl_Y[64], fdtbl_UV[64];
	for (int row = 0, k = 0; row < 8; ++row) {
		for (int col = 0; col < 8; ++col, ++k) {
			fdtbl_Y [k] = 1.0f / (YTable [s_jo_ZigZag[k]] * aasf[row] * aasf[col]);
			fdtbl_UV[k] = 1.0f / (UVTable[s_jo_ZigZag[k]] * aasf[row] * aasf[col]);
		}
	}

	/* Headers */
	static const uint8_t head0[] = {
		0xFF, 0xD8,
		0xFF, 0xE0, 0, 0x10, 'J','F','I','F', 0, 1, 1, 0, 0, 1, 0, 1, 0, 0,
		0xFF, 0xDB, 0, 0x84, 0
	};
	put_bytes(&o, head0, sizeof(head0));
	put_bytes(&o, YTable, sizeof(YTable));
	put_u8(&o, 1);
	put_bytes(&o, UVTable, sizeof(UVTable));

	const uint8_t head1[] = {
		0xFF, 0xC0, 0, 0x11, 8,
		(uint8_t)(height >> 8), (uint8_t)(height & 0xFF),
		(uint8_t)(width  >> 8), (uint8_t)(width  & 0xFF),
		3,
		1, (uint8_t)(subsample ? 0x22 : 0x11), 0,
		2, 0x11, 1,
		3, 0x11, 1,
		0xFF, 0xC4, 0x01, 0xA2, 0
	};
	put_bytes(&o, head1, sizeof(head1));
	put_bytes(&o, std_dc_luminance_nrcodes + 1, sizeof(std_dc_luminance_nrcodes) - 1);
	put_bytes(&o, std_dc_luminance_values,      sizeof(std_dc_luminance_values));
	put_u8(&o, 0x10);
	put_bytes(&o, std_ac_luminance_nrcodes + 1, sizeof(std_ac_luminance_nrcodes) - 1);
	put_bytes(&o, std_ac_luminance_values,      sizeof(std_ac_luminance_values));
	put_u8(&o, 1);
	put_bytes(&o, std_dc_chrominance_nrcodes + 1, sizeof(std_dc_chrominance_nrcodes) - 1);
	put_bytes(&o, std_dc_chrominance_values,      sizeof(std_dc_chrominance_values));
	put_u8(&o, 0x11);
	put_bytes(&o, std_ac_chrominance_nrcodes + 1, sizeof(std_ac_chrominance_nrcodes) - 1);
	put_bytes(&o, std_ac_chrominance_values,      sizeof(std_ac_chrominance_values));
	static const uint8_t head2[] = { 0xFF, 0xDA, 0, 0xC, 3, 1, 0, 2, 0x11, 3, 0x11, 0, 0x3F, 0 };
	put_bytes(&o, head2, sizeof(head2));

	const int comp = 3;
	int bitBuf = 0, bitCnt = 0;
	int DCY = 0, DCU = 0, DCV = 0;

	if (subsample) {
		float Y[256], U[256], V[256];
		for (int y = 0; y < height; y += 16) {
			for (int x = 0; x < width; x += 16) {
				int pos;
				float subU[64], subV[64];
				for (int row = y; row < y + 16; ++row) {
					for (int col = x; col < x + 16; ++col) {
						int prow = row >= height ? height - 1 : row;
						int pcol = col >= width  ? width  - 1 : col;
						int p = prow * width * comp + pcol * comp;
						pos = (row - y) * 16 + (col - x);
						jo_calcYUV(&Y[pos], &U[pos], &V[pos],
							   rgb[p], rgb[p + 1], rgb[p + 2]);
					}
				}
				DCY = jo_processDU(&o, &bitBuf, &bitCnt, Y +   0, 16, fdtbl_Y, DCY, YDC_HT, YAC_HT);
				DCY = jo_processDU(&o, &bitBuf, &bitCnt, Y +   8, 16, fdtbl_Y, DCY, YDC_HT, YAC_HT);
				DCY = jo_processDU(&o, &bitBuf, &bitCnt, Y + 128, 16, fdtbl_Y, DCY, YDC_HT, YAC_HT);
				DCY = jo_processDU(&o, &bitBuf, &bitCnt, Y + 136, 16, fdtbl_Y, DCY, YDC_HT, YAC_HT);
				for (int yy = 0, p = 0; yy < 8; ++yy) {
					for (int xx = 0; xx < 8; ++xx, ++p) {
						int j = yy * 32 + xx * 2;
						subU[p] = (U[j + 0] + U[j + 1] + U[j + 16] + U[j + 17]) * 0.25f;
						subV[p] = (V[j + 0] + V[j + 1] + V[j + 16] + V[j + 17]) * 0.25f;
					}
				}
				DCU = jo_processDU(&o, &bitBuf, &bitCnt, subU, 8, fdtbl_UV, DCU, UVDC_HT, UVAC_HT);
				DCV = jo_processDU(&o, &bitBuf, &bitCnt, subV, 8, fdtbl_UV, DCV, UVDC_HT, UVAC_HT);
			}
		}
	} else {
		float Y[64], U[64], V[64];
		for (int y = 0; y < height; y += 8) {
			for (int x = 0; x < width; x += 8) {
				int pos;
				for (int row = y; row < y + 8; ++row) {
					for (int col = x; col < x + 8; ++col) {
						int prow = row >= height ? height - 1 : row;
						int pcol = col >= width  ? width  - 1 : col;
						int p = prow * width * comp + pcol * comp;
						pos = (row - y) * 8 + (col - x);
						jo_calcYUV(&Y[pos], &U[pos], &V[pos],
							   rgb[p], rgb[p + 1], rgb[p + 2]);
					}
				}
				DCY = jo_processDU(&o, &bitBuf, &bitCnt, Y, 8, fdtbl_Y,  DCY, YDC_HT, YAC_HT);
				DCU = jo_processDU(&o, &bitBuf, &bitCnt, U, 8, fdtbl_UV, DCU, UVDC_HT, UVAC_HT);
				DCV = jo_processDU(&o, &bitBuf, &bitCnt, V, 8, fdtbl_UV, DCV, UVDC_HT, UVAC_HT);
			}
		}
	}

	static const unsigned short fillBits[] = { 0x7F, 7 };
	jo_writeBits(&o, &bitBuf, &bitCnt, fillBits);
	put_u8(&o, 0xFF);
	put_u8(&o, 0xD9);

	return o.overflow ? -1 : o.pos;
}
```

## src/jpeg_enc.h
```c
/*
 * jpeg_enc.h — minimal in-memory JPEG encoder (ported from Jon Olick's
 * public-domain jo_jpeg.cpp v1.61).
 *
 * Encodes RGB888 (3 bytes/pixel, packed RGB order) into a baseline JPEG
 * written to a caller-supplied output buffer.
 *
 *   width, height : must both be multiples of 16 (we use chroma subsampling)
 *   quality       : 1..100 ; <=90 enables 4:2:0 subsampling for smaller files
 *
 * Returns total JPEG bytes written, or -1 if `out_cap` is too small.
 */
#ifndef JPEG_ENC_H
#define JPEG_ENC_H

#include <stdint.h>

int jpeg_encode_rgb888(uint8_t *out, int out_cap,
		       const uint8_t *rgb, int width, int height, int quality);

#endif /* JPEG_ENC_H */
```
