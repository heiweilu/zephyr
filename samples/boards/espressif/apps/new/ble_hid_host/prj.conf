## CMakeLists.txt
```
# SPDX-License-Identifier: Apache-2.0

cmake_minimum_required(VERSION 3.20.0)
find_package(Zephyr REQUIRED HINTS $ENV{ZEPHYR_BASE})
project(ble_hid_host)

target_sources(app PRIVATE src/main.c)
```

## prj.conf
```kconfig
# Bluetooth
CONFIG_BT=y
CONFIG_BT_CENTRAL=y
CONFIG_BT_SMP=y
CONFIG_BT_GATT_CLIENT=y
CONFIG_BT_GATT_AUTO_DISCOVER_CCC=y

# Connection parameters
CONFIG_BT_MAX_CONN=2
CONFIG_BT_MAX_PAIRED=4

# ATT/GATT
CONFIG_BT_ATT_TX_COUNT=4
CONFIG_BT_L2CAP_TX_BUF_COUNT=4
CONFIG_BT_BUF_ACL_RX_SIZE=256
CONFIG_BT_BUF_ACL_TX_SIZE=256

# Security - needed for HID keyboards
CONFIG_BT_SMP_SC_ONLY=n
CONFIG_BT_SMP_SC_PAIR_ONLY=n
CONFIG_BT_SMP_ENFORCE_MITM=n
CONFIG_BT_BONDABLE=y

# Logging
CONFIG_LOG=y
CONFIG_BT_LOG_LEVEL_INF=y

# Console
CONFIG_CONSOLE=y
CONFIG_UART_CONSOLE=y
CONFIG_PRINTK=y
```

## boards/esp32s3_devkitc_procpu.overlay
```dts
/* Console via USB Serial/JTAG (COM5) */
/ {
	chosen {
		zephyr,console = &usb_serial;
		zephyr,shell-uart = &usb_serial;
	};
};

&usb_serial {
	status = "okay";
};

/* Enable BLE HCI controller for ESP32-S3 */
&esp32_bt_hci {
	status = "okay";
};
```

## src/main_minimal.c
```c
/* Minimal BLE test - just bt_enable and scan */
#include <zephyr/kernel.h>
#include <zephyr/sys/printk.h>
#include <zephyr/bluetooth/bluetooth.h>
#include <zephyr/bluetooth/hci.h>

static void device_found(const bt_addr_le_t *addr, int8_t rssi, uint8_t type,
			  struct net_buf_simple *ad)
{
	char dev[BT_ADDR_LE_STR_LEN];
	bt_addr_le_to_str(addr, dev, sizeof(dev));
	printk("[SCAN] %s RSSI %d\n", dev, rssi);
}

int main(void)
{
	int err;

	printk("\n\n=== BLE Minimal Test ===\n");
	printk("Calling bt_enable...\n");

	err = bt_enable(NULL);
	if (err) {
		printk("bt_enable failed (err %d)\n", err);
		return 0;
	}

	printk("Bluetooth initialized OK!\n");

	struct bt_le_scan_param scan_param = {
		.type     = BT_LE_SCAN_TYPE_ACTIVE,
		.options  = BT_LE_SCAN_OPT_NONE,
		.interval = BT_GAP_SCAN_FAST_INTERVAL,
		.window   = BT_GAP_SCAN_FAST_WINDOW,
	};

	err = bt_le_scan_start(&scan_param, device_found);
	if (err) {
		printk("Scan start failed (err %d)\n", err);
		return 0;
	}

	printk("Scanning...\n");
	return 0;
}
```
