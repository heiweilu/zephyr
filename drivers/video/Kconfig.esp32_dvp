## drivers/video/Kconfig.esp32_dvp
```kconfig
# Copyright (c) 2024 Espressif Systems (Shanghai) Co., Ltd.
# SPDX-License-Identifier: Apache-2.0

config VIDEO_ESP32
	bool "Video interface driver"
	select DMA
	depends on DT_HAS_ESPRESSIF_ESP32_LCD_CAM_ENABLED
	default y
	help
	  This option enables the video interface for the esp32s3.

config VIDEO_ESP32_DMA_BUFFER_MAX_SIZE
	int "ESP32 video DMA block size"
	depends on VIDEO_ESP32
	default 4095
	range 4 4095
	help
	  Size of each DMA block prepared by the ESP32 lcd_cam video driver.
	  Some boards need a 4-byte aligned value such as 4092 to match the
	  underlying GDMA descriptor payload limit.
```

## drivers/video/Kconfig.ov3660
```kconfig
# OV3660

# SPDX-License-Identifier: Apache-2.0

config VIDEO_OV3660
	bool "OV3660 CMOS digital image sensor"
	select I2C
	depends on DT_HAS_OVTI_OV3660_ENABLED
	default y
	help
	  Enable driver for OV3660 CMOS digital image sensor device.

config VIDEO_OV3660_COLOR_BAR_TEST
	bool "OV3660 color bar test pattern"
	depends on VIDEO_OV3660
	default n
	help
	  Enable the OV3660 built-in color bar generator for board-specific
	  diagnostics. This should only be enabled by the sample or board under
	  test, not globally for all users of the driver.
```

## dts/bindings/video/ovti,ov3660.yaml
```yaml
# SPDX-License-Identifier: Apache-2.0

description: OV3660 CMOS video sensor

compatible: "ovti,ov3660"

properties:
  reset-gpios:
    type: phandle-array
    description: |
      The RESET pin is asserted low to reset the sensor.

  powerdown-gpios:
    type: phandle-array
    description: |
      Optional PWDN pin. Active high powers the sensor down.

include: i2c-device.yaml
```

## samples/modules/lvgl/demos/boards/esp32s3_devkitc_procpu.conf
```kconfig
# CHD-ESP32-S3-BOX board config for LVGL demos

# GPIO for backlight
CONFIG_GPIO=y

# SPI + Display
CONFIG_SPI=y
CONFIG_MIPI_DBI=y

# Serial (USB console)
CONFIG_SERIAL=y
CONFIG_CONSOLE=y
CONFIG_UART_CONSOLE=y

# Widgets demo
CONFIG_LV_Z_DEMO_WIDGETS=y

# 16-bit color, byte-swap for SPI
CONFIG_LV_COLOR_DEPTH_16=y
CONFIG_LV_COLOR_16_SWAP=y
```
